## package/recalbox-system/Config.in
```kconfig
config BR2_PACKAGE_RECALBOX_SYSTEM
	bool "Recalbox System"
	select BR2_PACKAGE_LBA_FINDER
	select BR2_PACKAGE_AVAHI_DAEMON
	select BR2_PACKAGE_USB_MODESWITCH_DATA
	select BR2_PACKAGE_AVAHI
	select BR2_PACKAGE_RECALBOX_BLUETOOTH
	select BR2_PACKAGE_RECALBOX_WIFI
	select BR2_PACKAGE_BRCM_BT_FIRMWARE if !BR2_PACKAGE_RECALBOX_LITE
	select BR2_PACKAGE_SAMBA4
	select BR2_PACKAGE_RECALBOX_MANAGER3
	select BR2_PACKAGE_RECALBOX_POSTCONF
	select BR2_PACKAGE_RECALBOX_FBV
	select BR2_PACKAGE_ALSA_UCM_CONF
	help
	  Install the recalbox system files

choice
	prompt "Recalbox target"
	default BR2_PACKAGE_RECALBOX_TARGET_RPI4
	help
	  Select Recalbox target hardware

config BR2_PACKAGE_RECALBOX_TARGET_RPI0
	bool "rpi0"
	select BR2_PACKAGE_RPI_FIRMWARE

config BR2_PACKAGE_RECALBOX_TARGET_RPI1
	bool "rpi1"
	select BR2_PACKAGE_RPI_FIRMWARE
	select BR2_PACKAGE_RPI_USERLAND

config BR2_PACKAGE_RECALBOX_TARGET_RPIZERO2LEGACY
	bool "rpizero2legacy"
	select BR2_PACKAGE_RPI_FIRMWARE
	select BR2_PACKAGE_RPI_USERLAND

config BR2_PACKAGE_RECALBOX_TARGET_RPI3
	bool "rpi3"
	select BR2_PACKAGE_RPI_FIRMWARE
	select BR2_PACKAGE_RECALBOX_VIDEO_KMSDRM
	select BR2_PACKAGE_MESA3D_GALLIUM_DRIVER_V3D
	select BR2_PACKAGE_MESA3D_GALLIUM_DRIVER_VC4
	select BR2_PACKAGE_RECALBOX_CRT
	select BR2_PACKAGE_RPI_DTOVERLAY
	select BR2_PACKAGE_EEPROMUTILS
	select BR2_PACKAGE_RPI_UTILS

config BR2_PACKAGE_RECALBOX_TARGET_RPIZERO2
	bool "rpizero2"
	select BR2_PACKAGE_RPI_FIRMWARE
	select BR2_PACKAGE_RECALBOX_VIDEO_KMSDRM
	select BR2_PACKAGE_MESA3D_GALLIUM_DRIVER_V3D
	select BR2_PACKAGE_MESA3D_GALLIUM_DRIVER_VC4
	select BR2_PACKAGE_RECALBOX_CRT
	select BR2_PACKAGE_RPI_DTOVERLAY

config BR2_PACKAGE_RECALBOX_TARGET_RPI4_64
	bool "rpi4_64"
	select BR2_PACKAGE_RPI_FIRMWARE
	select BR2_PACKAGE_RPI_FIRMWARE_VARIANT_PI4
	select BR2_PACKAGE_RECALBOX_VIDEO_XWAYLAND
	select BR2_PACKAGE_RECALBOX_VIDEO_KMSDRM
	select BR2_PACKAGE_MESA3D_GALLIUM_DRIVER_V3D
	select BR2_PACKAGE_MESA3D_GALLIUM_DRIVER_VC4
	select BR2_PACKAGE_RECALBOX_CRT
	select BR2_PACKAGE_EEPROMUTILS
	select BR2_PACKAGE_RPI_EEPROM
	select BR2_PACKAGE_RPI_UTILS
	select BR2_PACKAGE_RECALBOX_ALLINONE
	select BR2_PACKAGE_RECALBOX_INPUT_LAG_TOOLS

config BR2_PACKAGE_RECALBOX_TARGET_RPI4
	bool "rpi4"
	select BR2_PACKAGE_RPI_FIRMWARE
	select BR2_PACKAGE_RPI_FIRMWARE_VARIANT_PI4
	select BR2_PACKAGE_RECALBOX_VIDEO_KMSDRM
	select BR2_PACKAGE_MESA3D_GALLIUM_DRIVER_V3D
	select BR2_PACKAGE_MESA3D_GALLIUM_DRIVER_VC4
	select BR2_PACKAGE_RECALBOX_CRT
	select BR2_PACKAGE_EEPROMUTILS

config BR2_PACKAGE_RECALBOX_TARGET_RPI5_64
	bool "rpi5_64"
	select BR2_PACKAGE_RPI_FIRMWARE
	select BR2_PACKAGE_RPI_FIRMWARE_VARIANT_PI4
	select BR2_PACKAGE_RECALBOX_VIDEO_XWAYLAND
	select BR2_PACKAGE_RECALBOX_VIDEO_KMSDRM
	select BR2_PACKAGE_MESA3D_GALLIUM_DRIVER_V3D
	select BR2_PACKAGE_MESA3D_GALLIUM_DRIVER_VC4
	select BR2_PACKAGE_RECALBOX_CRT
	select BR2_PACKAGE_RECALBOX_RGB_DUAL_2
	select BR2_PACKAGE_EEPROMUTILS
	select BR2_PACKAGE_RPI_EEPROM
	select BR2_PACKAGE_RPI_UTILS
	select BR2_PACKAGE_RECALBOX_CARD_READER
	select BR2_PACKAGE_RECALBOX_ALLINONE
	select BR2_PACKAGE_RECALBOX_INPUT_LAG_TOOLS

config BR2_PACKAGE_RECALBOX_TARGET_ODROIDXU4
	bool "odroidxu4"
	select BR2_PACKAGE_RECALBOX_VIDEO_KMSDRM
	select BR2_PACKAGE_HOST_UBOOT_TOOLS

config BR2_PACKAGE_RECALBOX_TARGET_ODROIDGO2
	bool "odroidgo2"
	select BR2_PACKAGE_RECALBOX_VIDEO_KMSDRM
	select BR2_PACKAGE_PM_UTILS
	select BR2_PACKAGE_ROCKCHIP_MPP
	select BR2_PACKAGE_HOST_UBOOT_TOOLS

config BR2_PACKAGE_RECALBOX_TARGET_RG353X
	bool "Anbernic RG353x family"
	select BR2_PACKAGE_RECALBOX_VIDEO_KMSDRM
	select BR2_PACKAGE_UBOOT_RG353X
	select BR2_PACKAGE_GPTFDISK
	select BR2_PACKAGE_GPTFDISK_SGDISK
	select BR2_PACKAGE_RKWIFIBT
	select BR2_PACKAGE_MESA3D
	select BR2_PACKAGE_MESA3D_GALLIUM_DRIVER_PANFROST
	select BR2_PACKAGE_MESA3D_OPENGL_EGL
	select BR2_PACKAGE_MESA3D_OPENGL_ES

config BR2_PACKAGE_RECALBOX_TARGET_X86_64
	bool "x86_64"
	select BR2_PACKAGE_RECALBOX_VIDEO_XORG_SERVER
	select BR2_PACKAGE_MESA3D_GALLIUM_DRIVER_LLVMPIPE
	select BR2_PACKAGE_MESA3D_GALLIUM_DRIVER_SOFTPIPE
	select BR2_PACKAGE_MESA3D_GALLIUM_DRIVER_CROCUS
	select BR2_PACKAGE_MESA3D_GALLIUM_DRIVER_I915
	select BR2_PACKAGE_MESA3D_GALLIUM_DRIVER_IRIS
	select BR2_PACKAGE_MESA3D_GALLIUM_DRIVER_NOUVEAU
	select BR2_PACKAGE_MESA3D_GALLIUM_DRIVER_R300
	select BR2_PACKAGE_MESA3D_GALLIUM_DRIVER_R600
	select BR2_PACKAGE_MESA3D_GALLIUM_DRIVER_RADEONSI
	select BR2_PACKAGE_SOUND_OPEN_FIRMWARE
	select BR2_PACKAGE_KERNELFIRMWARES_STEAMDECK

endchoice

# configure features
config BR2_PACKAGE_RECALBOX_HAS_LIBGLES
	bool
	default y if \
	  BR2_PACKAGE_RECALBOX_TARGET_RPI1 ||\
	  BR2_PACKAGE_RECALBOX_TARGET_RPIZERO2 ||\
	  BR2_PACKAGE_RECALBOX_TARGET_RPIZERO2LEGACY ||\
	  BR2_PACKAGE_RECALBOX_TARGET_RPI3 ||\
	  BR2_PACKAGE_RECALBOX_TARGET_RPI4 ||\
	  BR2_PACKAGE_RECALBOX_TARGET_RPI4_64 ||\
	  BR2_PACKAGE_RECALBOX_TARGET_RPI5_64 ||\
	  BR2_PACKAGE_RECALBOX_TARGET_ODROIDXU4 ||\
	  BR2_PACKAGE_RECALBOX_TARGET_ODROIDGO2 ||\
	  BR2_PACKAGE_RECALBOX_TARGET_RG353X

config BR2_PACKAGE_RECALBOX_HAS_LIBGLES3
	bool
	default y if \
	  BR2_PACKAGE_RECALBOX_TARGET_RPI4 ||\
	  BR2_PACKAGE_RECALBOX_TARGET_RPI4_64 ||\
	  BR2_PACKAGE_RECALBOX_TARGET_RPI5_64 ||\
	  BR2_PACKAGE_RECALBOX_TARGET_ODROIDXU4 ||\
	  BR2_PACKAGE_RECALBOX_TARGET_ODROIDGO2 ||\
	  BR2_PACKAGE_RECALBOX_TARGET_RG353X

config BR2_PACKAGE_RECALBOX_HAS_LIBGL
	bool
	default y if \
	  BR2_PACKAGE_RECALBOX_TARGET_X86_64 ||\
	  BR2_PACKAGE_RECALBOX_TARGET_RPI4_64 ||\
	  BR2_PACKAGE_RECALBOX_TARGET_RPI5_64

config BR2_PACKAGE_RECALBOX_HAS_VULKAN
	bool
	default y if \
	  BR2_PACKAGE_RECALBOX_TARGET_RPI4_64 ||\
	  BR2_PACKAGE_RECALBOX_TARGET_RPI5_64 ||\
	  BR2_PACKAGE_RECALBOX_TARGET_X86_64
	select BR2_PACKAGE_VULKAN_LOADER
	select BR2_PACKAGE_MESA3D_VULKAN_DRIVER_BROADCOM if (BR2_PACKAGE_RECALBOX_TARGET_RPI4_64 || BR2_PACKAGE_RECALBOX_TARGET_RPI5_64)
	select BR2_PACKAGE_MESA3D_VULKAN_DRIVER_INTEL if BR2_PACKAGE_RECALBOX_TARGET_X86_64
	select BR2_PACKAGE_MESA3D_VULKAN_DRIVER_HASWELL if BR2_PACKAGE_RECALBOX_TARGET_X86_64
	select BR2_PACKAGE_MESA3D_VULKAN_DRIVER_AMD if BR2_PACKAGE_RECALBOX_TARGET_X86_64

config BR2_PACKAGE_RECALBOX_HAS_KMS
	bool
	default y if \
	  BR2_PACKAGE_RECALBOX_TARGET_RPIZERO2 ||\
	  BR2_PACKAGE_RECALBOX_TARGET_RPI3 ||\
	  BR2_PACKAGE_RECALBOX_TARGET_RPI4 ||\
	  BR2_PACKAGE_RECALBOX_TARGET_RPI4_64 ||\
	  BR2_PACKAGE_RECALBOX_TARGET_RPI5_64 ||\
	  BR2_PACKAGE_RECALBOX_TARGET_ODROIDXU4 ||\
	  BR2_PACKAGE_RECALBOX_TARGET_ODROIDGO2 ||\
	  BR2_PACKAGE_RECALBOX_TARGET_RG353X

config BR2_PACKAGE_RECALBOX_HAS_MESA3D
	bool
	default y if \
	  BR2_PACKAGE_RECALBOX_TARGET_RPIZERO2 ||\
	  BR2_PACKAGE_RECALBOX_TARGET_RPI3 ||\
	  BR2_PACKAGE_RECALBOX_TARGET_RPI4 ||\
	  BR2_PACKAGE_RECALBOX_TARGET_RPI4_64 ||\
	  BR2_PACKAGE_RECALBOX_TARGET_RPI5_64 ||\
	  BR2_PACKAGE_RECALBOX_TARGET_X86_64
	select BR2_PACKAGE_MESA3D_DEMOS

config BR2_PACKAGE_RECALBOX_HAS_LIBMALI
	bool
	default y if \
	  BR2_PACKAGE_RECALBOX_TARGET_ODROIDXU4 ||\
	  BR2_PACKAGE_RECALBOX_TARGET_ODROIDGO2

config BR2_PACKAGE_RECALBOX_EGL_NO_X11
	bool
	default y if \
	  BR2_PACKAGE_RECALBOX_TARGET_RPI1 ||\
	  BR2_PACKAGE_RECALBOX_TARGET_RPIZERO2 ||\
	  BR2_PACKAGE_RECALBOX_TARGET_RPIZERO2LEGACY ||\
	  BR2_PACKAGE_RECALBOX_TARGET_RPI3 ||\
	  BR2_PACKAGE_RECALBOX_TARGET_RPI4 ||\
	  BR2_PACKAGE_RECALBOX_TARGET_ODROIDXU4 ||\
	  BR2_PACKAGE_RECALBOX_TARGET_ODROIDGO2 ||\
	  BR2_PACKAGE_RECALBOX_TARGET_RG353X

# shader slang (used by retroarch)
config BR2_PACKAGE_RECALBOX_HAS_SLANG
	bool
	default y if \
	  BR2_PACKAGE_RECALBOX_TARGET_RPI4_64 ||\
	  BR2_PACKAGE_RECALBOX_TARGET_RPI5_64 ||\
	  BR2_PACKAGE_RECALBOX_TARGET_ODROIDGO2

# various helpers
config BR2_PACKAGE_RECALBOX_RPI_ANY
	bool
	default y if \
	  BR2_PACKAGE_RECALBOX_TARGET_RPI1 ||\
	  BR2_PACKAGE_RECALBOX_TARGET_RPIZERO2 ||\
	  BR2_PACKAGE_RECALBOX_TARGET_RPIZERO2LEGACY ||\
	  BR2_PACKAGE_RECALBOX_TARGET_RPI3 ||\
	  BR2_PACKAGE_RECALBOX_TARGET_RPI4 ||\
	  BR2_PACKAGE_RECALBOX_TARGET_RPI4_64 ||\
	  BR2_PACKAGE_RECALBOX_TARGET_RPI5_64

# recalbox lite
config BR2_PACKAGE_RECALBOX_LITE
	bool "recalbox lite"
	default n

# video backends
config BR2_PACKAGE_RECALBOX_VIDEO_KMSDRM
	bool
	select BR2_PACKAGE_MESA3D if BR2_PACKAGE_RECALBOX_HAS_MESA3D
	select BR2_PACKAGE_MESA3D_OPENGL_ES if BR2_PACKAGE_RECALBOX_HAS_MESA3D
	select BR2_PACKAGE_MESA3D_OPENGL_EGL if BR2_PACKAGE_RECALBOX_HAS_MESA3D
	select BR2_PACKAGE_RECALBOX_ROCKCHIP_MALI if BR2_PACKAGE_RECALBOX_TARGET_ODROIDGO2
	select BR2_PACKAGE_LIBRELEC_LIBMALI if BR2_PACKAGE_RECALBOX_TARGET_ODROIDXU4
	select BR2_PACKAGE_SDL2
	select BR2_PACKAGE_SDL2_KMSDRM
	select BR2_PACKAGE_SDL3
	select BR2_PACKAGE_SDL3_OPENGLES
	select BR2_PACKAGE_SDL3_KMSDRM

config BR2_PACKAGE_RECALBOX_VIDEO_XORG_SERVER
	bool
	select BR2_PACKAGE_XORG7
	select BR2_PACKAGE_XSERVER_XORG_SERVER
	select BR2_PACKAGE_MESA3D
	select BR2_PACKAGE_MESA3D_LLVM
	select BR2_PACKAGE_MESA3D_OPENGL_EGL
	select BR2_PACKAGE_MESA3D_OPENGL_GLX
	select BR2_PACKAGE_SDL2
	select BR2_PACKAGE_SDL2_X11
	select BR2_PACKAGE_SDL2_OPENGL
	select BR2_PACKAGE_XLIB_LIBXI
	select BR2_PACKAGE_RECALBOX_DRM_INFO

config BR2_PACKAGE_RECALBOX_VIDEO_XWAYLAND
	bool
	select BR2_PACKAGE_DWL
	select BR2_PACKAGE_WLR_RANDR
	select BR2_PACKAGE_XORG7
	select BR2_PACKAGE_LIBEPOXY
	select BR2_PACKAGE_XWAYLAND
	select BR2_PACKAGE_WLROOTS
	select BR2_PACKAGE_WLROOTS_XWAYLAND
	select BR2_PACKAGE_MESA3D
	select BR2_PACKAGE_MESA3D_LLVM
	select BR2_PACKAGE_MESA3D_OPENGL_EGL
	select BR2_PACKAGE_MESA3D_OPENGL_GLX
	select BR2_PACKAGE_SDL2
	select BR2_PACKAGE_SDL2_KMSDRM
	select BR2_PACKAGE_SDL2_X11
	select BR2_PACKAGE_SDL2_OPENGL
	select BR2_PACKAGE_XLIB_LIBXI
	select BR2_PACKAGE_GRIM

config BR2_PACKAGE_RECALBOX_QT6
	bool
	select BR2_PACKAGE_QT6
	select BR2_PACKAGE_QT6BASE
	select BR2_PACKAGE_QT6BASE_DBUS
	select BR2_PACKAGE_QT6BASE_GUI
	select BR2_PACKAGE_QT6BASE_NETWORK
	select BR2_PACKAGE_QT6BASE_VULKAN    if BR2_PACKAGE_RECALBOX_HAS_VULKAN
	select BR2_PACKAGE_QT6BASE_WIDGETS
	select BR2_PACKAGE_QT6BASE_PNG
	select BR2_PACKAGE_QT6BASE_XML
	select BR2_PACKAGE_QT6BASE_FONTCONFIG
	select BR2_PACKAGE_QT6BASE_OPENGL		if BR2_PACKAGE_RECALBOX_HAS_LIBGL
	select BR2_PACKAGE_QT6BASE_OPENGL_DESKTOP	if BR2_PACKAGE_RECALBOX_HAS_LIBGL
	select BR2_PACKAGE_QT6BASE_OPENGL_ES2		if BR2_PACKAGE_RECALBOX_HAS_LIBGLES
	select BR2_PACKAGE_QT6BASE_XCB			if (BR2_PACKAGE_XSERVER_XORG_SERVER || BR2_PACKAGE_XWAYLAND)
	select BR2_PACKAGE_QT6BASE_EGLFS		if BR2_PACKAGE_HAS_LIBEGL
	select BR2_PACKAGE_QT6SVG
	select BR2_PACKAGE_QT6WAYLAND    if BR2_PACKAGE_WAYLAND

config BR2_PACKAGE_STEAMDECK_SUPPORT
	bool "Valve Steamdeck support"
	depends on BR2_x86_64
	select BR2_PACKAGE_VALVE_HARDWARE_AUDIO_PROCESSING

config BR2_PACKAGE_USE_VOLUMED
	bool "Recalbox volumed support"
	default y if \
	  BR2_PACKAGE_RECALBOX_TARGET_RPI1 ||\
	  BR2_PACKAGE_RECALBOX_TARGET_RPIZERO2 ||\
	  BR2_PACKAGE_RECALBOX_TARGET_RPIZERO2LEGACY ||\
	  BR2_PACKAGE_RECALBOX_TARGET_RPI3 ||\
	  BR2_PACKAGE_RECALBOX_TARGET_RPI4 ||\
	  BR2_PACKAGE_RECALBOX_TARGET_RPI4_64 ||\
	  BR2_PACKAGE_RECALBOX_TARGET_RPI5_64 ||\
	  BR2_PACKAGE_RECALBOX_TARGET_X86_64
	select BR2_PACKAGE_RECALBOX_VOLUMED
```

## package/retroarch/Config.in
```kconfig
config BR2_PACKAGE_RETROARCH
	bool "Retroarch"
	depends on BR2_PACKAGE_RECALBOX_SYSTEM
	select BR2_PACKAGE_NANOARCH
	select BR2_PACKAGE_RETROARCH_ASSETS
	select BR2_PACKAGE_FLAC
	select BR2_PACKAGE_XSERVER_XORG_SERVER if BR2_PACKAGE_RECALBOX_VIDEO_XORG_SERVER
	select BR2_PACKAGE_XWAYLAND if BR2_PACKAGE_RECALBOX_VIDEO_XWAYLAND
	select BR2_PACKAGE_ALSA_LIB
	select BR2_PACKAGE_FREETYPE
	select BR2_PACKAGE_LIBUSB
	select BR2_PACKAGE_PULSEAUDIO
	select BR2_PACKAGE_SDL
	select BR2_PACKAGE_SDL2
	select BR2_PACKAGE_VULKAN_LOADER
	select BR2_PACKAGE_XLIB_LIBX11 if BR2_PACKAGE_RECALBOX_VIDEO_XORG_SERVER
	select BR2_PACKAGE_XLIB_LIBXEXT if BR2_PACKAGE_RECALBOX_VIDEO_XORG_SERVER
	select BR2_PACKAGE_ZLIB
	help
	  A multi emulator frontend.

	  http://www.libretro.com

comment "Retroarch depends on EGL or OpenGLES"
	depends on !(BR2_PACKAGE_HAS_LIBEGL || BR2_PACKAGE_HAS_LIBGLES || BR2_PACKAGE_HAS_LIBGL)
```

## package/switchres/Config.in
```kconfig
config BR2_PACKAGE_SWITCHRES
	bool "switchres"
	select BR2_PACKAGE_HOST_DOS2UNIX
	select BR2_PACKAGE_LIBDRM
	help
	  Switchres is a modeline generation engine for emulation.
	  https://github.com/antonioginer/switchres
```

## package/utilities/recalbox-fbv/Config.in
```kconfig
config BR2_PACKAGE_RECALBOX_FBV
	bool "recalbox-fbv"
	select BR2_PACKAGE_LIBPNG
	select BR2_PACKAGE_JPEG
	select BR2_PACKAGE_GIFLIB
	help
	  fbv is a very simple graphic file viewer for the framebuffer
	  console, capable of displaying GIF, JPEG, PNG and BMP files
	  using libungif, libjpeg and libpng.

	  http://freshmeat.net/projects/fbv/
```

## package/vvvvvv/Config.in
```kconfig
config BR2_PACKAGE_VVVVVV
	bool "vvvvvv"
	select BR2_PACKAGE_SDL2
	help
	  The source code to VVVVVV!
	  https://github.com/TerryCavanagh/VVVVVV
```

## package/wii-u-gc-adapter/Config.in
```kconfig
config BR2_PACKAGE_WII_U_GC_ADAPTER
	bool "wii-u-gc-adapter"
	select BR2_PACKAGE_LIBUSB
	help
	  Tool for using the Wii U GameCube Adapter on Linux
```
