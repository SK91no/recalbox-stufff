## package/ppsspp/Config.in
```kconfig
config BR2_PACKAGE_PPSSPP
	bool "ppsspp"
	depends on BR2_PACKAGE_SDL2
	depends on BR2_PACKAGE_ZLIB
	depends on BR2_PACKAGE_FFMPEG_SWSCALE
	select BR2_PACKAGE_SNAPPY
	select BR2_PACKAGE_VULKAN_LOADER
	select BR2_PACKAGE_ZIP
	select BR2_PACKAGE_LIBGLU if BR2_PACKAGE_HAS_LIBGL
	help
	  A  PSP emulator
```

## package/python-pygame2/Config.in
```kconfig
config BR2_PACKAGE_PYTHON_PYGAME2
	bool "python-pygame"
	select BR2_PACKAGE_SDL
	help
	  Pygame is a cross-platfrom library designed to make it easy
	  to write multimedia software, such as games, in
	  Python. Pygame requires the Python language and SDL
	  multimedia library.
	  It can also make use of several other popular libraries.

	  http://www.pygame.org/

if BR2_PACKAGE_PYTHON_PYGAME2
config BR2_PACKAGE_PYTHON_PYGAME2_IMAGE
	bool "pygame.image"
	select BR2_PACKAGE_SDL_IMAGE
	select BR2_PACKAGE_SDL_IMAGE_PNG
	select BR2_PACKAGE_SDL_IMAGE_JPEG
	help
	  pygame module for loading, saving and transfering images.
	  Will autoselect sdl_image with png and jpeg support.

config BR2_PACKAGE_PYTHON_PYGAME2_EXAMPLES
	bool "pygame.examples"
	help
	  Include examples.
	  Selecting this option adds about 1.5 MB to the target file
	  system.

config BR2_PACKAGE_PYTHON_PYGAME2_FONT
	bool "pygame.font"
	select BR2_PACKAGE_SDL_TTF
	help
	  pygame module for loading and rendering fonts.
	  Will autoselect sdl_ttf.

config BR2_PACKAGE_PYTHON_PYGAME2_MIXER
	bool "pygame.mixer"
	select BR2_PACKAGE_SDL_MIXER
	help
	  pygame module for loading and playing sounds.
	  Will autoselect sdl_mixer.

config BR2_PACKAGE_PYTHON_PYGAME2_SCRAP
	bool "pygame.scrap"
	depends on BR2_PACKAGE_SDL_X11
	select BR2_PACKAGE_SDL2
	select BR2_PACKAGE_SDL2_IMAGE
	select BR2_PACKAGE_SDL2_MIXER
	select BR2_PACKAGE_SDL2_TTF
	help
	  pygame module for clipboard support (X11 needed)

endif
```

## package/python-rpi-lgpio/Config.in
```kconfig
config BR2_PACKAGE_PYTHON_RPI_LGPIO
	bool "python-rpi-lgpio"
	depends on BR2_arm || BR2_aarch64
	select BR2_PACKAGE_PYTHON_LGPIO
	help
	  A Python module to control the GPIO on a Raspberry Pi.

	  https://github.com/waveform80/rpi-lgpio
```

## package/qtsixa-shanwan/Config.in
```kconfig
config BR2_PACKAGE_QTSIXA_SHANWAN
	bool "qtsixashanwan"
	depends on BR2_PACKAGE_QTSIXA
	select BR2_PACKAGE_SDL
	help
	  Support for ps3 controllers.

comment "qtsixashanwan depends on qtsixa"
	depends on !BR2_PACKAGE_QTSIXA
```

## package/recalbox-3mounts/Config.in
```kconfig
config BR2_PACKAGE_RECALBOX_3MOUNTS
	bool "recalbox 3mounts"
	depends on BR2_USE_MMU # lockfile-progs -> liblockfile
	depends on BR2_PACKAGE_HAS_UDEV
	select BR2_PACKAGE_LOCKFILE_PROGS
	help
	  The 3mounts utility for recalbox
```

## package/recalbox-card-reader/Config.in
```kconfig
config BR2_PACKAGE_RECALBOX_CARD_READER
	bool "Recalbox card reader dts and driver"
	depends on BR2_LINUX_KERNEL
	select BR2_PACKAGE_RECALBOX_HARDWARE
	help
	  Support for Recalbox card reader
	  for Rasbperry Pi 5

comment "Recalbox card reader needs a kernel and headers"
	depends on !BR2_LINUX_KERNEL
```

## package/recalbox-configgen/Config.in
```kconfig
config BR2_PACKAGE_RECALBOX_CONFIGGEN
	bool "recalbox configgen"
	select BR2_PACKAGE_PYTHON3
	select BR2_PACKAGE_PYTHON_PYUDEV
	select BR2_PACKAGE_PYTHON_LIBEVDEV
	select BR2_PACKAGE_PYTHON_PYGAME2
	select BR2_PACKAGE_PYTHON_PYGAME2_IMAGE
	select BR2_PACKAGE_PYTHON_PYGAME2_FONT
	select BR2_PACKAGE_PYTHON_PILLOW
	help
	  The configuration utility for recalbox

	  https://gitlab.com/recalbox/recalbox-configgen
```

## package/recalbox-crt/Config.in
```kconfig
config BR2_PACKAGE_RECALBOX_CRT
	bool "recalbox crt"
	select BR2_PACKAGE_RECALBOX_RGB_DUAL
	select BR2_PACKAGE_RECALBOX_RGB_JAMMA
	select BR2_PACKAGE_RECALBOX_RGB_JAMMA_2
	select BR2_PACKAGE_RECALBOX_RGB_DUAL_GUNCON2

	help
	  Crt tv support for recalbox

	  https://gitlab.com/recalbox/recalbox
```

## package/recalbox-drm-info/Config.in
```kconfig
config BR2_PACKAGE_RECALBOX_DRM_INFO
	bool "recalbox-drm-info"
	depends on BR2_PACKAGE_XORG7
	select BR2_PACKAGE_LIBDRM
	select BR2_PACKAGE_XLIB_LIBXRANDR
	select BR2_PACKAGE_XLIB_LIBX11
	help
	  Recalbox DRM information
```

## package/recalbox-emulationstation2/Config.in
```kconfig
config BR2_PACKAGE_RECALBOX_EMULATIONSTATION2
	bool "recalbox Emulationstation 2"
	depends on BR2_INSTALL_LIBSTDCPP
	depends on BR2_PACKAGE_ALSA_LIB
	depends on BR2_PACKAGE_ALSA_UTILS_AMIXER
	depends on BR2_PACKAGE_FFMPEG_ARCH_SUPPORTS # ffmpeg
	depends on (BR2_PACKAGE_HAS_LIBGLES || BR2_PACKAGE_HAS_LIBGL)
	select BR2_PACKAGE_SDL2
	select BR2_PACKAGE_SDL2_MIXER
	select BR2_PACKAGE_FFMPEG
	select BR2_PACKAGE_FFMPEG_AVRESAMPLE
	select BR2_PACKAGE_FFMPEG_SWSCALE
	select BR2_PACKAGE_LIBFREEIMAGE
	select BR2_PACKAGE_FREETYPE
	select BR2_PACKAGE_DEJAVU
	select BR2_PACKAGE_OPENSSL
	select BR2_PACKAGE_LIBCURL
	select BR2_PACKAGE_LIBZIP
	select BR2_PACKAGE_RAPIDJSON
	select BR2_PACKAGE_XZ
	select BR2_PACKAGE_XMLSTARLET
	select BR2_PACKAGE_RECALBOX_3MOUNTS
	select BR2_PACKAGE_PROCPS_NG
	select BR2_PACKAGE_RECALBOX_MUPDF
	select BR2_PACKAGE_MUPDF
	# Pulled in only for alpha/patron builds where DeathTrap uses it to walk
	# the stack via .eh_frame (more robust than libgcc on stripped binaries).
	# Gated by libunwind's own arch/toolchain requirements so the select is a
	# no-op on configurations where libunwind cannot be built.
	select BR2_PACKAGE_LIBUNWIND if BR2_PACKAGE_LIBUNWIND_ARCH_SUPPORTS && \
		BR2_TOOLCHAIN_HAS_THREADS && BR2_TOOLCHAIN_GCC_AT_LEAST_4_9 && \
		!BR2_STATIC_LIBS
	help
	  A multi emulator frontend.

	  https://github.com/Aloshi/EmulationStation

if BR2_PACKAGE_RECALBOX_EMULATIONSTATION2
choice
	prompt "ES version to compile"
config BR2_PACKAGE_RECALBOX_EMULATIONSTATION2_STANDARD
	bool "standard"
config BR2_PACKAGE_RECALBOX_EMULATIONSTATION2_ARCADE
	bool "arcade"
endchoice
endif

comment "Emulation station 2 needs a toolchain w/ C++, ALSA, Boost, GLES and SDL2"
	depends on !BR2_INSTALL_LIBSTDCPP || !BR2_PACKAGE_SDL2 || !BR2_PACKAGE_SDL2_MIXER || \
		!BR2_PACKAGE_ALSA_LIB || (!BR2_PACKAGE_HAS_LIBGLES || !BR2_PACKAGE_HAS_LIBGL)
```

## package/recalbox-gamepad-proxy/Config.in
```kconfig
config BR2_PACKAGE_RECALBOX_GAMEPAD_PROXY
	bool "Recalbox gamepad proxy driver"
	depends on BR2_LINUX_KERNEL
	select BR2_PACKAGE_RECALBOX_HARDWARE
	help
	  Support for gamepad proxy

comment "Recalbox gamepad proxy driver needs a kernel and headers"
	depends on !BR2_LINUX_KERNEL
```

## package/recalbox-initramfs/Config.in
```kconfig
config BR2_PACKAGE_RECALBOX_INITRAMFS
	bool "Recalbox initramfs"
	default n
	select BR2_PACKAGE_LIBXCRYPT
	help
	  A simple initramfs based on busybox.

	  http://busybox.net/
```

## package/recalbox-input-lag-tools/Config.in
```kconfig
config BR2_PACKAGE_RECALBOX_INPUT_LAG_TOOLS
	bool "Recalbox input lag tools"
	depends on BR2_LINUX_KERNEL
	select BR2_PACKAGE_LIBGPIOD2
	select BR2_PACKAGE_LIBGPIOD2_TOOLS
	help
	  Support for Recalbox input lag tools
```

## package/recalbox-jvs/Config.in
```kconfig
config BR2_PACKAGE_RECALBOX_JVS
	bool "Recalbox jvs dts"
	depends on BR2_LINUX_KERNEL
	select BR2_PACKAGE_PYTHON_ESPTOOL
	help
	  Support for Recalbox JVS for RPi 5

comment "Recalbox JVS needs a kernel and headers"
	depends on !BR2_LINUX_KERNEL
```

## package/recalbox-mplayer/Config.in
```kconfig
config BR2_PACKAGE_RECALBOX_MPLAYER
	bool "recalbox-mplayer"
	depends on BR2_TOOLCHAIN_HAS_SYNC_4
	depends on BR2_TOOLCHAIN_HAS_THREADS
	select BR2_PACKAGE_ALSA_LIB
	select BR2_PACKAGE_FAAD2
	select BR2_PACKAGE_FONTCONFIG
	select BR2_PACKAGE_FREETYPE
	select BR2_PACKAGE_LAME
	select BR2_PACKAGE_LIBASS
	select BR2_PACKAGE_LIBFRIBIDI
	select BR2_PACKAGE_LIBICONV
	select BR2_PACKAGE_LIBMAD
	select BR2_PACKAGE_LIBMPEG2
	select BR2_PACKAGE_LIBVORBIS
	select BR2_PACKAGE_LZO
	select BR2_PACKAGE_MPG123
	select BR2_PACKAGE_NCURSES
	select BR2_PACKAGE_TREMOR
	help
	  MPlayer is a movie player which runs on many systems and
	  supports many different file formats.

	  http://www.mplayerhq.hu/

comment "recalbox-mplayer needs a toolchain w/ threads"
	depends on BR2_TOOLCHAIN_HAS_SYNC_4
	depends on !BR2_TOOLCHAIN_HAS_THREADS
```

## package/recalbox-rgb-dual/Config.in
```kconfig
config BR2_PACKAGE_RECALBOX_RGB_DUAL
	bool "Recalbox RGB Dual 1 and 2 dts and driver"
	depends on BR2_LINUX_KERNEL
	help
	  Support for Recalbox RGB Dual 1 & 2,
	  the dual scart and vga dac
	  for Rasbperry Pi 4, 400, 3 and Zero2

comment "Recalbox RGB Dual needs a kernel and headers"
	depends on !BR2_LINUX_KERNEL
```

## package/recalbox-rgb-jamma-2/Config.in
```kconfig
config BR2_PACKAGE_RECALBOX_RGB_JAMMA_2
	bool "Recalbox RGB Jamma dts and driver"
	depends on BR2_LINUX_KERNEL
	select BR2_PACKAGE_RECALBOX_RGB_DUAL
	select BR2_PACKAGE_RECALBOX_RGB_JAMMA
	select BR2_PACKAGE_RECALBOX_I2S_AUDIO
	select BR2_PACKAGE_RPI_UTILS
	select BR2_PACKAGE_MOSQUITTO
	select BR2_PACKAGE_LIBDRM
	select BR2_PACKAGE_RECALBOX_HARDWARE
	select BR2_PACKAGE_RECALBOX_GAMEPAD_PROXY
	help
	  Support for Recalbox RGB Jamma 2, the Recalbox JAMMA adapter
	  for Rasbperry Pi 5

comment "Recalbox RGB Jamma 2 needs a kernel and headers"
	depends on !BR2_LINUX_KERNEL
```

## package/recalbox-rgb-jamma/Config.in
```kconfig
config BR2_PACKAGE_RECALBOX_RGB_JAMMA
	bool "Recalbox RGB Jamma dts and driver"
	depends on BR2_LINUX_KERNEL
	select BR2_PACKAGE_RECALBOX_RGB_DUAL
	select BR2_PACKAGE_RECALBOX_I2S_AUDIO
	select BR2_PACKAGE_RPI_UTILS
	select BR2_PACKAGE_MOSQUITTO
	select BR2_PACKAGE_LIBDRM
	select BR2_PACKAGE_RECALBOX_HARDWARE
	help
	  Support for Recalbox RGB Jamma, the JAMMA adapter
	  for Rasbperry Pi 5, 4, 400, and 3

comment "Recalbox RGB Jamma needs a kernel and headers"
	depends on !BR2_LINUX_KERNEL
```

## package/recalbox-settings/Config.in
```kconfig
config BR2_PACKAGE_RECALBOX_SETTINGS
	bool "recalbox settings"
	depends on BR2_INSTALL_LIBSTDCPP
	select BR2_PACKAGE_ZLIB
	help
	  A simple & fast settings manager.

	  https://github.com/recalbox/recalbox-settings
```
