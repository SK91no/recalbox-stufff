## package/wildmidi/Config.in
```kconfig
config BR2_PACKAGE_WILDMIDI
	bool "wildmidi"
	select BR2_PACKAGE_ALSA_LIB
	help
	  WildMIDI is a simple software midi
	  player which has a core softsynth
	  library that canbe used with other
	  applications.
	  https://github.com/Mindwerks/wildmidi
```

## package/wlr-randr/Config.in
```kconfig
config BR2_PACKAGE_WLR_RANDR
	bool "wlr-randr"
	depends on BR2_PACKAGE_DWL
	select BR2_PACKAGE_WAYLAND
	select BR2_PACKAGE_WAYLAND_PROTOCOLS
	# Runtime dependencies
	help
	  wlr-randr allow to change dwl resolution

	  https://github.com/emersion/wlr-randr
```
