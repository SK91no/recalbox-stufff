## package/libretro-exel-hence/Config.in
```kconfig
config BR2_PACKAGE_LIBRETRO_EXEL_HENCE
	bool "libretro-exel-hence"
	depends on BR2_PACKAGE_RETROARCH
	select BR2_PACKAGE_ZLIB
	help
	  Exelvision EXL 100

	  http://gitlab.com/recalbox/packages/recalbox-cores/libretro-exel-hence

comment "exel-hence needs retroarch"
	depends on BR2_PACKAGE_RETROARCH
```

## package/libretro-flycast-next/Config.in
```kconfig
config BR2_PACKAGE_LIBRETRO_FLYCAST_NEXT
	bool "libretro-flycast-next"
	depends on BR2_PACKAGE_RETROARCH
	depends on BR2_INSTALL_LIBSTDCPP
	depends on BR2_GCC_ENABLE_OPENMP
	depends on BR2_PACKAGE_ARCADE_DATS
	select BR2_PACKAGE_VULKAN_HEADERS
	help
	  A libretro atomiswave, dreamcast and naomi core.

	  http://www.libretro.com

comment "LIBRETRO_FLYCAST needs a toolchain w/ C++"
	depends on !BR2_INSTALL_LIBSTDCPP
```

## package/libretro-geargrafx/Config.in
```kconfig
config BR2_PACKAGE_LIBRETRO_GEARGRAFX
	bool "libretro-geargrafx"
	depends on BR2_PACKAGE_RETROARCH
	help
	  PC Engine / TurboGrafx-16 / SuperGrafx emulator

	  http://www.libretro.com
	  https://github.com/drhelius/Geargrafx
```

## package/libretro-genesisplusgx-ex/Config.in
```kconfig
config BR2_PACKAGE_LIBRETRO_GENESISPLUSGX_EX
	bool "libretro-genesisplusgx-ex"
	depends on BR2_PACKAGE_RETROARCH
	depends on BR2_INSTALL_LIBSTDCPP
	help
	  Expanded MAXROMSIZE for Sega Channel Revival.

	  http://github.com/BillyTimeGames/Genesis-Plus-GX-Expanded-Rom-Size

comment "LIBRETRO_GENESISPLUSGX_EX needs a toolchain w/ C++"
	depends on !BR2_INSTALL_LIBSTDCPP
```

## package/libretro-geolith/Config.in
```kconfig
config BR2_PACKAGE_LIBRETRO_GEOLITH
	bool "libretro-geolith"
	depends on BR2_PACKAGE_RETROARCH
	depends on BR2_INSTALL_LIBSTDCPP
	select BR2_PACKAGE_ZLIB
	help
	  Geolith is a highly accurate Neo Geo AES/MVS emulator

	  https://github.com/libretro/geolith-libretro

comment "LIBRETRO_GEOLITH needs a toolchain w/ C++"
	depends on !BR2_INSTALL_LIBSTDCPP
```

## package/libretro-holani/Config.in
```kconfig
config BR2_PACKAGE_LIBRETRO_HOLANI
	bool "libretro-holani"
	depends on BR2_PACKAGE_RETROARCH
	select BR2_PACKAGE_CLANG
	help
	  Libretro implementation of holani, an Atari Lynx emulator

	  http://www.libretro.com
```

## package/libretro-m2000/Config.in
```kconfig
config BR2_PACKAGE_LIBRETRO_M2000
	bool "libretro-m2000"
	depends on BR2_PACKAGE_RETROARCH
	depends on BR2_INSTALL_LIBSTDCPP
	help
	  M2000 - Philips P2000T Home Computer Emulator

	  https://github.com/p2000t/M2000

comment "LIBRETRO_M2000 needs a toolchain w/ C++"
	depends on !BR2_INSTALL_LIBSTDCPP
```

## package/libretro-mame0258/Config.in
```kconfig
config BR2_PACKAGE_LIBRETRO_MAME0258
	bool "libretro-mame0258"
	depends on BR2_PACKAGE_RETROARCH
	depends on BR2_INSTALL_LIBSTDCPP
	select BR2_PACKAGE_ARCADE_DATS
	select BR2_PACKAGE_ZLIB
	select BR2_PACKAGE_ALSA_LIB
	help
	  A libretro mame core for x86_64 - Based on MAME 0.258.

	  http://www.libretro.com

comment "LIBRETRO_MAME0258 needs a toolchain w/ C++"
	depends on !BR2_INSTALL_LIBSTDCPP
```

## package/libretro-mame0278/Config.in
```kconfig
config BR2_PACKAGE_LIBRETRO_MAME0278
	bool "libretro-mame0278"
	depends on BR2_PACKAGE_RETROARCH
	depends on BR2_INSTALL_LIBSTDCPP
	select BR2_PACKAGE_ARCADE_DATS
	select BR2_PACKAGE_ZLIB
	select BR2_PACKAGE_ALSA_LIB
	help
	  A libretro mame core for x86_64 - Based on MAME 0.278.

	  http://www.libretro.com

comment "BR2_PACKAGE_LIBRETRO_MAME0278 needs a toolchain w/ C++"
	depends on !BR2_INSTALL_LIBSTDCPP
```

## package/libretro-mednafen-stv/Config.in
```kconfig
config BR2_PACKAGE_LIBRETRO_MEDNAFEN_STV
	bool "libretro-mednafen-stv"
	depends on BR2_PACKAGE_RETROARCH
	select BR2_PACKAGE_ARCADE_DATS
	select BR2_PACKAGE_ZLIB
	select BR2_PACKAGE_ZSTD
	help
	  A libretro core for ST-V.

	  http://www.libretro.com
	  https://github.com/beudbeud/libretro-stv
```

## package/libretro-pd777/Config.in
```kconfig
config BR2_PACKAGE_LIBRETRO_PD777
	bool "libretro-pd777"
	depends on BR2_PACKAGE_RETROARCH
	depends on BR2_INSTALL_LIBSTDCPP
	select BR2_PACKAGE_ZLIB
	help
	  A libretro Cassette Vision emulator.

	  http://www.libretro.com

comment "LIBRETRO_PD777 needs a toolchain w/ C++"
	depends on !BR2_INSTALL_LIBSTDCPP
```

## package/libretro-ppsspp/Config.in
```kconfig
config BR2_PACKAGE_LIBRETRO_PPSSPP
	bool "libretro-ppsspp"
	depends on BR2_PACKAGE_RETROARCH
	depends on BR2_INSTALL_LIBSTDCPP
	select BR2_PACKAGE_RECALBOX_ROMFS_PSP
	select BR2_PACKAGE_FFMPEG
	select BR2_PACKAGE_LIBPNG
	select BR2_PACKAGE_SDL2
	select BR2_PACKAGE_SNAPPY
	select BR2_PACKAGE_VULKAN_HEADERS
	select BR2_PACKAGE_XSERVER_XORG_SERVER if BR2_PACKAGE_RECALBOX_VIDEO_XORG_SERVER
	select BR2_PACKAGE_ZIP
	help
	  A libretro PSP emulator core.

	  http://www.libretro.com

comment "LIBRETRO_PPSSPP needs a toolchain w/ C++"
	depends on !BR2_INSTALL_LIBSTDCPP
```

## package/libretro-ps2/Config.in
```kconfig
config BR2_PACKAGE_LIBRETRO_PS2
	bool "libretro-ps2"
	depends on BR2_PACKAGE_RETROARCH
	depends on BR2_INSTALL_LIBSTDCPP
	depends on BR2_PACKAGE_XZ
	select BR2_PACKAGE_LIBAIO
	select BR2_PACKAGE_VULKAN_HEADERS
	help
	  A Sony PS2 libretro core.

	  https://www.libretro.com

comment "LIBRETRO_PS2 needs a toolchain w/ C++"
	depends on !BR2_INSTALL_LIBSTDCPP
```

## package/libretro-rb5000/Config.in
```kconfig
config BR2_PACKAGE_LIBRETRO_RB5000
	bool "rb5000"
	depends on BR2_PACKAGE_RETROARCH
	depends on BR2_INSTALL_LIBSTDCPP
	help
	  Phillips VG 5000 Emulator

	  http://gitlab.com/bkg2k/rb5000

comment "Gsplus needs a toolchain w/ OpenGl, SDL2"
	depends on BR2_PACKAGE_SDL2
```

## package/libretro-scummvm/Config.in
```kconfig
config BR2_PACKAGE_LIBRETRO_SCUMMVM
	bool "libretro-scummvm"
	depends on BR2_PACKAGE_RETROARCH
	depends on BR2_INSTALL_LIBSTDCPP
	select BR2_PACKAGE_FAAD2
	select BR2_PACKAGE_FLAC
	select BR2_PACKAGE_FLUIDSYNTH
	select BR2_PACKAGE_FREETYPE
	select BR2_PACKAGE_JPEG_TURBO
	select BR2_PACKAGE_LIBFRIBIDI
	select BR2_PACKAGE_LIBMAD
	select BR2_PACKAGE_LIBMPEG2
	select BR2_PACKAGE_LIBOGG
	select BR2_PACKAGE_LIBPNG
	select BR2_PACKAGE_LIBTHEORA
	select BR2_PACKAGE_LIBVORBIS
	select BR2_PACKAGE_ZLIB
	help
	  A libretro SCUMMVM emulator core.

	  http://www.libretro.com

comment "LIBRETRO_SCUMMVM needs a toolchain w/ C++"
	depends on !BR2_INSTALL_LIBSTDCPP
```

## package/libretro-sugarbox2/Config.in
```kconfig
config BR2_PACKAGE_LIBRETRO_SUGARBOX2
	bool "libretro-sugarbox2"
	depends on BR2_PACKAGE_RETROARCH
	depends on BR2_INSTALL_LIBSTDCPP
	select BR2_PACKAGE_ZLIB
	help
	  An Amstrad CPC/CPC+/GX4000 libretro core.

	  https://gitlab.com/recalbox/packages/recalbox-cores/libretro-sugarbox2

comment "LIBRETRO_SUGARBOX2 needs a toolchain w/ C++"
	depends on !BR2_INSTALL_LIBSTDCPP
```

## package/libretro-tamalibretro/Config.in
```kconfig
config BR2_PACKAGE_LIBRETRO_TAMALIBRETRO
	bool "libretro-tamalibretro"
	depends on BR2_PACKAGE_RETROARCH
	help
	  TamaLIB Tamagotchi P1 emulator implementation
	  in the libretro API

	  https://github.com/celerizer/tamalibretro?tab=readme-ov-file
```

## package/libretro-vircon32/Config.in
```kconfig
config BR2_PACKAGE_LIBRETRO_VIRCON32
	bool "libretro-vircon32"
	depends on BR2_PACKAGE_RETROARCH
	depends on BR2_INSTALL_LIBSTDCPP
	help
	  Vircon32 is a virtual game console 16 & 32 bit systems

	  https://github.com/vircon32/vircon32-libretro

comment "LIBRETRO_VIRCON32 needs a toolchain w/ C++"
	depends on !BR2_INSTALL_LIBSTDCPP
```

## package/libretro-ymir/Config.in
```kconfig
config BR2_PACKAGE_LIBRETRO_YMIR
	bool "libretro-ymir"
	depends on BR2_PACKAGE_RETROARCH
	select BR2_PACKAGE_LIBZLIB
	select BR2_PACKAGE_ZSTD
	help
	  Sega Saturn emulator.

	  https://github.com/StrikerX3/Ymir
```

## package/libvni/Config.in
```kconfig
config BR2_PACKAGE_LIBVNI
	bool "libvni"
	help
	  Cross platform dynamic library for VNI pinball sound format.

	  https://github.com/PPUC/libvni
```

## package/libwinevbs/Config.in
```kconfig
config BR2_PACKAGE_LIBWINEVBS
	bool "libwinevbs"
	help
	  Wine-based VBScript engine for Visual Pinball on Linux.
	  Provides windows.h and ATL/MFC headers.

	  https://github.com/vpinball/libwinevbs
```

## package/moonlight-embedded/Config.in
```kconfig
config BR2_PACKAGE_MOONLIGHT_EMBEDDED
	bool "moonlight-embedded"
	select BR2_PACKAGE_OPUS
	select BR2_PACKAGE_EXPAT
	select BR2_PACKAGE_LIBEVDEV
	select BR2_PACKAGE_AVAHI
	select BR2_PACKAGE_ALSA_LIB
	select BR2_PACKAGE_LIBCURL
	select BR2_PACKAGE_LIBCEC
	select BR2_PACKAGE_FFMPEG
	select BR2_PACKAGE_LIBENET
	select BR2_PACKAGE_RPI_FIRMWARE \
		if BR2_PACKAGE_RECALBOX_TARGET_RPI3  || \
		   BR2_PACKAGE_RECALBOX_TARGET_RPIZERO2 || \
		   BR2_PACKAGE_RECALBOX_TARGET_RPI4_64  || \
		   BR2_PACKAGE_RECALBOX_TARGET_RPI5_64
	select BR2_PACKAGE_LIBDRM \
		if BR2_PACKAGE_RECALBOX_TARGET_RPI3     || \
		   BR2_PACKAGE_RECALBOX_TARGET_RPI4_64  || \
		   BR2_PACKAGE_RECALBOX_TARGET_RPI5_64
	select BR2_PACKAGE_SDL2 \
		if BR2_PACKAGE_RECALBOX_TARGET_X86_64
	select BR2_PACKAGE_PULSEAUDIO \
		if BR2_PACKAGE_RECALBOX_TARGET_X86_64
	select BR2_PACKAGE_LIBVA \
		if BR2_PACKAGE_RECALBOX_TARGET_X86_64
	select BR2_PACKAGE_XLIB_LIBX11 \
		if BR2_PACKAGE_RECALBOX_TARGET_X86_64
	select BR2_PACKAGE_LIBAMCODEC \
		if BR2_PACKAGE_LIBAMCODEC
	help
	  Gamestream client for embedded systems.
	  https://github.com/irtimmer/moonlight-embedded/wiki
```

## package/openlara/Config.in
```kconfig
config BR2_PACKAGE_OPENLARA
	bool "openlara"
	depends on BR2_INSTALL_LIBSTDCPP
	select BR2_PACKAGE_SDL2
	select BR2_PACKAGE_SDL2_NET
	select BR2_PACKAGE_SDL2_MIXER
	select BR2_PACKAGE_SDL2_IMAGE
	help
	  Openlara is an open source port of Tomb Raider.

	  https://github.com/XProger/OpenLara

comment "Openlara needs a toolchain w/ C++, SDL2"
	depends on !BR2_INSTALL_LIBSTDCPP
```

## package/pcsx_rearmed/Config.in
```kconfig
config BR2_PACKAGE_PCSX_REARMED
	bool "pcsx_rearmed"
	depends on BR2_INSTALL_LIBSTDCPP
	select BR2_PACKAGE_LIBPNG
	select BR2_PACKAGE_PULSEAUDIO
	select BR2_PACKAGE_SDL
	select BR2_PACKAGE_ZLIB
	help
	  A psx emulator core for ARM.

	  http://github.com/notaz/pcsx_rearmed

comment "PCSX_REARMED needs a toolchain w/ C++"
	depends on !BR2_INSTALL_LIBSTDCPP
```

## package/pico8-lexaloffle/Config.in
```kconfig
config BR2_PACKAGE_PICO8_LEXALOFFLE
	bool "pico8-lexaloffle"
	help
	  Support for the official pico-8 core

	  https://www.lexaloffle.com/pico-8.php
```
