## package/dwl/Config.in
```kconfig
config BR2_PACKAGE_DWL
	bool "dwl"
	select BR2_PACKAGE_WAYLAND
	select BR2_PACKAGE_WAYLAND_PROTOCOLS
	select BR2_PACKAGE_WLROOTS
	select BR2_PACKAGE_WLROOTS_XWAYLAND
	select BR2_PACKAGE_LIBINPUT
	select BR2_PACKAGE_LIBXKBCOMMON
	select BR2_PACKAGE_LIBXCB
	select BR2_PACKAGE_SEATD
	help
	  dwl is a compact, hackable compositor for Wayland
	  based on wlroots. It is intended to fill the same space
	  in the Wayland world that dwm does in X11, primarily
	  in terms of philosophy, and secondarily in terms
	  of functionality.

	  https://codeberg.org/dwl/dwl
```

## package/kodi-resource-language-eu_es/Config.in
```kconfig
config BR2_PACKAGE_KODI_RESOURCE_LANGUAGE_eu_es
	bool "kodi-resource-language-eu_es"
	default y
	depends on BR2_PACKAGE_KODI
	help
	  Kodi Basque language resource

	  https://mirrors.kodi.tv/addons/matrix/resource.language.eu_es/
```

## package/kodi-resource-language-fr_fr/Config.in
```kconfig
config BR2_PACKAGE_KODI_RESOURCE_LANGUAGE_fr_fr
	bool "kodi-resource-language-fr_fr"
	default y
	depends on BR2_PACKAGE_KODI
	help
	  Kodi French language resource

	  https://mirrors.kodi.tv/addons/matrix/resource.language.fr_fr/
```

## package/kodi-resource-language-sv_se/Config.in
```kconfig
config BR2_PACKAGE_KODI_RESOURCE_LANGUAGE_sv_se
	bool "kodi-resource-language-sv_se"
	default y
	depends on BR2_PACKAGE_KODI
	help
	  Kodi Swedish language resource

	  https://mirrors.kodi.tv/addons/matrix/resource.language.sv_se/
```

## package/kodi-resource-language-tr_tr/Config.in
```kconfig
config BR2_PACKAGE_KODI_RESOURCE_LANGUAGE_tr_tr
	bool "kodi-resource-language-tr_tr"
	default y
	depends on BR2_PACKAGE_KODI
	help
	  Kodi Turkish language resource

	  https://mirrors.kodi.tv/addons/matrix/resource.language.tr_tr/
```

## package/lgpio/Config.in
```kconfig
config BR2_PACKAGE_LGPIO
	bool "lgpio"
	depends on BR2_arm || BR2_aarch64
	help
	  lgpio is a module for Linux Single Board Computers

	  https://github.com/joan2937/lg
```

## package/libretro-arduous/Config.in
```kconfig
config BR2_PACKAGE_LIBRETRO_ARDUOUS
	bool "libretro-arduous"
	depends on BR2_PACKAGE_RETROARCH
	depends on BR2_INSTALL_LIBSTDCPP
	help
	  Arduboy is a portable game based on the Arduino hardware.

	  https://github.com/libretro/arduous

comment "LIBRETRO_ARDUOUS needs a toolchain w/ C++"
	depends on !BR2_INSTALL_LIBSTDCPP
```

## package/libretro-mame2003/Config.in
```kconfig
config BR2_PACKAGE_LIBRETRO_MAME2003
	bool "libretro-mame2003"
	depends on BR2_PACKAGE_RETROARCH
	depends on BR2_INSTALL_LIBSTDCPP
	select BR2_PACKAGE_ARCADE_DATS
	help
	  A libretro mame2003 core for ARM.

	  http://www.libretro.com

comment "LIBRETRO_MAME2003 needs a toolchain w/ C++"
	depends on !BR2_INSTALL_LIBSTDCPP
```

## package/libretro-supafaust/Config.in
```kconfig
config BR2_PACKAGE_LIBRETRO_SUPAFAUST
	bool "libretro-supafaust"
	depends on BR2_PACKAGE_RETROARCH
	depends on BR2_INSTALL_LIBSTDCPP
	help
	  A libretro SNES emulator core.

	  http://www.libretro.com

comment "LIBRETRO_SUPAFAUST needs a toolchain w/ C++"
	depends on !BR2_INSTALL_LIBSTDCPP
```

## package/libretro-wasm4/Config.in
```kconfig
config BR2_PACKAGE_LIBRETRO_WASM4
	bool "libretro-wasm4"
	depends on BR2_PACKAGE_RETROARCH
	depends on BR2_INSTALL_LIBSTDCPP
	help
	  WASM-4 is a game console that builds games with WebAssembly.

	  https://github.com/aduros/wasm4

comment "LIBRETRO_WASM4 needs a toolchain w/ C++"
	depends on !BR2_INSTALL_LIBSTDCPP
```

## package/nodejs-quasar/Config.in.host
```kconfig
config BR2_PACKAGE_HOST_NODEJS_QUASAR
	bool "host nodejs quasar"
	select HOST_NODEJS
	help
	  Quasar Framework - Build high-performance VueJS user interfaces
	  in record time
	  https://github.com/quasarframework/quasar
```

## package/python-lgpio/Config.in
```kconfig
config BR2_PACKAGE_PYTHON_LGPIO
	bool "python-lgpio"
	depends on BR2_arm || BR2_aarch64
	select BR2_PACKAGE_LGPIO
	help
	  lgpio is a module for Linux Single Board Computers

	  https://abyz.me.uk/lg/py_lgpio.html
```

## package/python-smbus2/Config.in
```kconfig
config BR2_PACKAGE_PYTHON_SMBUS2
	bool "python smbus2"
	select BR2_PACKAGE_PYTHON3
	help
	  Smbus2 Support

	  https://github.com/kplindegaard/smbus2
```

## package/recalbox-allinone/Config.in
```kconfig
config BR2_PACKAGE_RECALBOX_ALLINONE
	bool "All In One dts and driver"
	depends on BR2_LINUX_KERNEL
	help
	  Support for digipcb/recalbox All In One
	  arcade board for Rasbperry Pi 5, 4

comment "allinone needs a kernel and headers"
	depends on !BR2_LINUX_KERNEL
```

## package/recalbox-i2s-audio/Config.in
```kconfig
config BR2_PACKAGE_RECALBOX_I2S_AUDIO
	bool "Recalbox I2S audio Driver"
	depends on BR2_LINUX_KERNEL
	help
	  Support for Recalbox I2S Aduio devices

comment "Recalbox I2S Audio needs a kernel and headers"
	depends on !BR2_LINUX_KERNEL
```

## package/recalbox-manager3/Config.in
```kconfig
config BR2_PACKAGE_RECALBOX_MANAGER3
	bool "recalbox webmanager v3"
	depends on BR2_INSTALL_LIBSTDCPP
	select BR2_PACKAGE_HOST_PYTHON3_BZIP2
	select BR2_PACKAGE_HOST_PYTHON3_SSL
	select BR2_PACKAGE_HOST_NODEJS_QUASAR
	help
	  Recalbox WebManager v3
	  https://gitlab.com/recalbox/recalbox-manager-v3

comment "RECALBOX_MANAGER3 needs a toolchain w/ C++"
	depends on !BR2_INSTALL_LIBSTDCPP
```

## package/recalbox-postconf/Config.in
```kconfig
config BR2_PACKAGE_RECALBOX_POSTCONF
	bool "recalbox-postconf"
	select BR2_PACKAGE_PYTHON3
	select BR2_PACKAGE_LIBYAML
	select BR2_PACKAGE_PYTHON_PYYAML
	select BR2_PACKAGE_RECALBOX_CONFIGGEN
	help
	  Install the recalbox postconfig script
```

## package/rpi-eeprom/Config.in
```kconfig
config BR2_PACKAGE_RPI_EEPROM
	bool "rpi-eeprom tools"
	depends on BR2_arm || BR2_aarch64
	depends on BR2_INSTALL_LIBSTDCPP
	depends on BR2_TOOLCHAIN_HAS_THREADS
	depends on !BR2_STATIC_LIBS
	help
	  Raspberry Pi eeprom binaires and flash utils
	  https://github.com/raspberrypi/rpi-eeprom

comment "rpi-eeprom needs a toolchain w/ C++, threads, dynamic library"
	depends on BR2_arm
	depends on !BR2_INSTALL_LIBSTDCPP || !BR2_TOOLCHAIN_HAS_THREADS || \
		BR2_STATIC_LIBS
```

## package/rpi-utils/Config.in
```kconfig
config BR2_PACKAGE_RPI_UTILS
	bool "rpi-userland tools"
	depends on BR2_arm || BR2_aarch64
	depends on BR2_INSTALL_LIBSTDCPP
	depends on BR2_TOOLCHAIN_HAS_THREADS
	depends on !BR2_STATIC_LIBS
	select BR2_PACKAGE_DTC
	help
	  Raspberry Pi Utils

comment "rpi-utils needs a toolchain w/ C++, threads, dynamic library"
	depends on BR2_arm
	depends on !BR2_INSTALL_LIBSTDCPP || !BR2_TOOLCHAIN_HAS_THREADS || \
		BR2_STATIC_LIBS
```

## package/rtw89/Config.in
```kconfig
comment "rtw89 needs a Linux kernel to be built"
	depends on !BR2_LINUX_KERNEL

config BR2_PACKAGE_RTW89
	bool "rtw89"
	depends on BR2_LINUX_KERNEL
	help
	  rtw89 wifi driver

	  https://github.com/lwfinger/rtw89
```

## package/sdlpop/Config.in
```kconfig
config BR2_PACKAGE_SDLPOP
	bool "SDLPoP"
	depends on BR2_INSTALL_LIBSTDCPP
	select BR2_PACKAGE_SDL2
	select BR2_PACKAGE_SDL2_IMAGE
	help
	  Port of Prince of Persia

	  https://github.com/NagyD/SDLPoP

comment "SDLPoP needs a toolchain w/ C++, and following libraries : sdl2 and sdl2_image"
	depends on !BR2_INSTALL_LIBSTDCPP || !BR2_PACKAGE_SDL2 || !BR2_PACKAGE_SDL2_IMAGE
```

## package/taito-pt/Config.in
```kconfig
config BR2_PACKAGE_TAITO_PT
	bool "taito-pt"
	help
	  Linux driver for the TAITO USB Paddle & Trackball Controller
	  https://github.com/rtomasa/taito-pt
```

## package/uboot-odroidgo2/Config.in
```kconfig
config BR2_PACKAGE_UBOOT_ODROIDGO2
	bool "U-Boot for Odroid GO2 and compatible"
	help
	  u-boot for odroid and compatible boards

	  https://github.com/hardkernel/u-boot/tree/odroidgoA-v2017.09
```

## package/xone/Config.in
```kconfig
config BR2_PACKAGE_XONE
	bool "xone"
	depends on BR2_LINUX_KERNEL
	help
	  Linux kernel driver for Xbox One and
	  Xbox Series X|S accessories
```

## package/xpad-noone/Config.in
```kconfig
config BR2_PACKAGE_XPAD_NOONE
	bool "xpad-noone"
	depends on BR2_LINUX_KERNEL
	help
	  This is the original xpad kernel driver
	  with support for Xbox One controllers removed.
	  https://github.com/medusalix/xpad-noone
```
