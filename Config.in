## package/advancemame/Config.in
```kconfig
config BR2_PACKAGE_ADVANCEMAME
	bool "advancemame"
	select BR2_PACKAGE_ARCADE_DATS
	select BR2_PACKAGE_ALSA_LIB
	select BR2_PACKAGE_FREETYPE
	select BR2_PACKAGE_RPI_FIRMWARE
	select BR2_PACKAGE_SDL2
	help
	  A MAME 0.106-based emulator
	  http://www.advancemame.it
```

## package/amiberry/Config.in
```kconfig
config BR2_PACKAGE_AMIBERRY
	bool "Amiberry"
	depends on !BR2_STATIC_LIBS  # sdl3, sdl3_image
	depends on BR2_PACKAGE_RECALBOX_SYSTEM
	select BR2_PACKAGE_SDL3
	select BR2_PACKAGE_MPG123
	select BR2_PACKAGE_SDL3_IMAGE
	select BR2_PACKAGE_LIBCAPSIMAGE
	select BR2_PACKAGE_FLAC
	select BR2_PACKAGE_LIBMPEG2
	select BR2_PACKAGE_LIBPNG
	select BR2_PACKAGE_LIBCURL
	select BR2_PACKAGE_JSON_FOR_MODERN_CPP
	select BR2_PACKAGE_ZSTD
	select BR2_PACKAGE_LIBXML2
	select BR2_PACKAGE_ZLIB
	help
	  An Amiga emulator

	  https://github.com/midwan/amiberry

comment "Amiberry needs a toolchain w/ dynamic library"
	depends on BR2_STATIC_LIBS
```

## package/audio/alsa-ucm-conf/Config.in
```kconfig
config BR2_PACKAGE_ALSA_UCM_CONF
	bool "Alsa UCM Conf"
	help
	  ALSA Use Case Manager configuration 

	  https://github.com/alsa-project/alsa-ucm-conf
```

## package/corsixth/Config.in
```kconfig
config BR2_PACKAGE_CORSIXTH
	bool "CorsixTH"
	depends on BR2_INSTALL_LIBSTDCPP
	select BR2_PACKAGE_FFMPEG
	select BR2_PACKAGE_FREETYPE
	select BR2_PACKAGE_LPEG
	select BR2_PACKAGE_LUA
	select BR2_PACKAGE_LUAFILESYSTEM
	select BR2_PACKAGE_LUASOCKET
	select BR2_PACKAGE_LUASEC
	select BR2_PACKAGE_SDL2
	select BR2_PACKAGE_SDL2_MIXER
	select BR2_PACKAGE_PUGIXML
	select BR2_PACKAGE_LIBCURL
	select BR2_PACKAGE_MBEDTLS
	help
	  Port of Theme Hospital

	  https://github.com/CorsixTH/CorsixTH

comment "CorsixTH needs a toolchain w/ C++"
	depends on !BR2_INSTALL_LIBSTDCPP
```

## package/dolphin-emu/Config.in
```kconfig
config BR2_PACKAGE_DOLPHIN_EMU
	bool "dolphin-emu"
	depends on BR2_x86_64 || BR2_aarch64
	select BR2_PACKAGE_RECALBOX_QT6
	select BR2_PACKAGE_QT6WAYLAND if BR2_PACKAGE_RECALBOX_VIDEO_XWAYLAND
	select BR2_PACKAGE_LIBEVDEV
	select BR2_PACKAGE_FFMPEG
	select BR2_PACKAGE_ZLIB
	select BR2_PACKAGE_LIBPNG
	select BR2_PACKAGE_LZO
	select BR2_PACKAGE_LIBUSB
	select BR2_PACKAGE_LIBCURL
	select BR2_PACKAGE_BLUEZ5_UTILS
	select BR2_PACKAGE_CAIRO_SCRIPT
	select BR2_PACKAGE_CAIRO
	select BR2_PACKAGE_HIDAPI
	select BR2_PACKAGE_XORG7 if (BR2_PACKAGE_RECALBOX_VIDEO_XORG_SERVER || BR2_PACKAGE_RECALBOX_VIDEO_XWAYLAND)
	select BR2_PACKAGE_XLIB_LIBXI if (BR2_PACKAGE_RECALBOX_VIDEO_XORG_SERVER || BR2_PACKAGE_RECALBOX_VIDEO_XWAYLAND)
	select BR2_PACKAGE_HICOLOR_ICON_THEME if BR2_PACKAGE_XORG7
	select BR2_PACKAGE_SFML if BR2_PACKAGE_XORG7
	select BR2_PACKAGE_QT6BASE
	select BR2_PACKAGE_QT6SVG
	select BR2_PACKAGE_SDL2
	select BR2_PACKAGE_VULKAN_HEADERS
	select BR2_PACKAGE_XSERVER_XORG_SERVER if BR2_PACKAGE_RECALBOX_VIDEO_XORG_SERVER
	select BR2_PACKAGE_XWAYLAND if BR2_PACKAGE_RECALBOX_VIDEO_XWAYLAND
	select BR2_PACKAGE_XZ
	help
	  A  Nintendo GameCube/Wii emulator.
	  https://github.com/dolphin-emu/dolphin

comment "Dolphin needs x86_64, XORG7 or aarch64"
	depends on (!BR2_x86_64 || !BR2_PACKAGE_XORG7) && !BR2_aarch64
```

## package/firmware/kernelfirmwares-steamdeck/Config.in
```kconfig
config BR2_PACKAGE_KERNELFIRMWARES_STEAMDECK
	bool "kernelfirmwares-steamdeck"
	help
	  This repository contains all these firmware images which
	  have been extracted from older drivers, as well various
	  new firmware images which we were never permitted to
	  include in a GPL'd work, but which we _have_ been
	  permitted to redistribute under separate cover.

	  https://gitlab.com/evlaV/linux-firmware-neptune
```

## package/firmware/sound-open-firmware/Config.in
```kconfig
config BR2_PACKAGE_SOUND_OPEN_FIRMWARE
	bool "Sound Open Firmware"
	help
	  Open source audio DSP firmware

	  https://www.sofproject.org/
```

## package/firmware/valve-hardware-audio-processing/Config.in
```kconfig
config BR2_PACKAGE_VALVE_HARDWARE_AUDIO_PROCESSING
	bool ""
	help
	  This repository contains any and all customizations audio configuration and processing we run on the Steam Deck.
	  This includes:
	  
	  - Configurations for source and sink setups in Pipewire for Voyager/Jupiter and Galileo.
	  - Wireplumber scripts for routing those sources/sinks for Voyager/Jupiter and Galileo.
	  - Individual UCM configs for session policy for Voyager/Jupiter (coupled with the acp5x soundcard) and Galileo (coupled with the sof-nau8821-max soundcard)
	  - Faust scripts for generating a statically compiled speaker and microphone tuning.
	  - Prebuilt and presigned SOF firmware binaries for the audio co-processor on Galileo.
	  - Scripts and a submodule setup for compiling an unsigned version of the SOF firmware binary for Galileo from source.

	  https://gitlab.com/evlaV/valve-hardware-audio-processing
```

## package/grim/Config.in
```kconfig
config BR2_PACKAGE_GRIM
	bool "grim"
	select BR2_PACKAGE_WAYLAND
	select BR2_PACKAGE_LIBPNG
	select BR2_PACKAGE_PIXMAN
	select BR2_PACKAGE_WAYLAND_PROTOCOLS
	help
	  Grab images from a Wayland compositor

	  https://gitlab.freedesktop.org/emersion/grim
```

## package/hardware/argon40case/Config.in
```kconfig
config BR2_PACKAGE_ARGON40CASE
	bool "Argon40Case"
	depends on BR2_PACKAGE_PYTHON3
	select BR2_PACKAGE_PYTHON_RPI_LGPIO
	help
	  Scripts and samples used by Argon40 Cases and HATs 
	  Scripts support ArgonOne & ArgonEon
	  Check download-scripts.sh for sources.
```

## package/hatari/Config.in
```kconfig
config BR2_PACKAGE_HATARI
	bool "hatari standalon"
	depends on BR2_INSTALL_LIBSTDCPP
	select BR2_PACKAGE_SDL2
	select BR2_PACKAGE_LIBZIP
	select BR2_PACKAGE_MTOOLS
	select BR2_PACKAGE_LIBCAPSIMAGE
	select BR2_PACKAGE_READLINE
	select BR2_PACKAGE_ZLIB

	help
	  Atari ST/STE/TT/Falcon emulator.

	  https://hatari.tuxfamily.org/

comment "Emulation station 2 needs a toolchain w/ C++, ALSA and SDL2"
	depends on !BR2_INSTALL_LIBSTDCPP || !BR2_PACKAGE_SDL2
```

## package/julius/Config.in
```kconfig
config BR2_PACKAGE_JULIUS
	bool "Julius"
	depends on BR2_INSTALL_LIBSTDCPP
	select BR2_PACKAGE_LIBPNG
	select BR2_PACKAGE_SDL2
	select BR2_PACKAGE_SDL2_MIXER
	help
	  Port of Caesar III

	  https://github.com/bvschaik/julius

comment "Julius needs a toolchain w/ C++, and following libraries : libpng, sdl2 and sdl2_mixer"
	depends on !BR2_INSTALL_LIBSTDCPP || !BR2_PACKAGE_LIBPNG || !BR2_PACKAGE_SDL2 || !BR2_PACKAGE_SDL2_MIXER
```

## package/kodi-plugin-video-crunchyroll/Config.in
```kconfig
config BR2_PACKAGE_KODI_PLUGIN_VIDEO_CRUNCHYROLL
	bool "kodi-plugin-video-crunchyroll"
	default y
	depends on BR2_PACKAGE_KODI
	select BR2_PACKAGE_KODI_PLUGIN_SCRIPT_ADDON_SIGNALS
	select BR2_PACKAGE_PYTHON_SIX
	select BR2_PACKAGE_KODI_SCRIPT_MODULE_INPUTSTREAMHELPER
	select BR2_PACKAGE_KODI_SCRIPT_MODULE_REQUESTS
	help
	  Kodi Crunchyroll Plugin

	  source https://github.com/smirgol/plugin.video.crunchyroll/
```

## package/kodi-plugin-video-freebox/Config.in
```kconfig
config BR2_PACKAGE_KODI_PLUGIN_VIDEO_FREEBOX
	bool "kodi-plugin-video-netflix"
	default y
	depends on BR2_PACKAGE_KODI
	select BR2_PACKAGE_JSON_FOR_MODERN_CPP
	help
	  Kodi + Freebox TV

	  https://github.com/aassif/pvr.freebox
```

## package/kodi-plugin-video-orange/Config.in
```kconfig
config BR2_PACKAGE_KODI_PLUGIN_VIDEO_ORANGE
	bool "kodi-plugin-video-orange"
	default y
	depends on BR2_PACKAGE_KODI
	select BR2_PACKAGE_PYTHON_REQUESTS
	select BR2_PACKAGE_KODI_SCRIPT_MODULE_INPUTSTREAMHELPER
	select BR2_PACKAGE_KODI_SCRIPT_MODULE_ROUTING
	help
	  Kodi Orange PVR Plugin

	  https://github.com/f-lawe/plugin.video.orange.fr
```

## package/kodi-plugin-video-plex/Config.in
```kconfig
config BR2_PACKAGE_KODI_PLUGIN_VIDEO_PLEX
	bool "kodi-plugin-video-plex"
	default y
	depends on BR2_PACKAGE_KODI
	select BR2_PACKAGE_PYTHON_REQUESTS
	select BR2_PACKAGE_KODI_SCRIPT_MODULE_PYTHON_TWITCH
	select BR2_PACKAGE_KODI_SCRIPT_MODULE_REQUESTS
	select BR2_PACKAGE_KODI_SCRIPT_MODULE_KODI_SIX
	help
	  Unoffical Plex for Kodi add-on.

	  source https://github.com/pannal/plex-for-kodi
```

## package/kodi-script-module-routing/Config.in
```kconfig
config BR2_PACKAGE_KODI_SCRIPT_MODULE_ROUTING
	bool "kodi-script-routing"
	default n
	depends on BR2_PACKAGE_KODI
	help
	  Kodi routing script module

	  https://mirrors.kodi.tv/addons/matrix/script.module.routing/
```

## package/libframeutil/Config.in
```kconfig
config BR2_PACKAGE_LIBFRAMEUTIL
	bool "libframeutil"
	help
	  Header-only library for pinball DMD frame processing.

	  https://github.com/PPUC/libframeutil
```

## package/libretro-amiberry/Config.in
```kconfig
config BR2_PACKAGE_LIBRETRO_AMIBERRY
	bool "libretro-Amiberry"
	select BR2_PACKAGE_ZLIB
	select BR2_PACKAGE_ZSTD
	help
	  An Amiga emulator

	  https://github.com/midwan/amiberry
```

## package/libretro-b2/Config.in
```kconfig
config BR2_PACKAGE_LIBRETRO_B2
	bool "libretro-b2"
	depends on BR2_PACKAGE_RETROARCH
	depends on BR2_INSTALL_LIBSTDCPP
	select BR2_PACKAGE_UTIL_LINUX_LIBS
	select BR2_PACKAGE_ZLIB
	help
	  Libretro b2 core - A BBC Micro emulator

	  https://github.com/zoltanvb/b2-libretro

comment "LIBRETRO_B2 needs a toolchain w/ C++"
	depends on !BR2_INSTALL_LIBSTDCPP
```

## package/libretro-dice/Config.in
```kconfig
config BR2_PACKAGE_LIBRETRO_DICE
	bool "libretro-dice"
	depends on BR2_PACKAGE_RETROARCH
	depends on BR2_INSTALL_LIBSTDCPP
	select BR2_PACKAGE_ARCADE_DATS
	help
	  DICE is a Discrete Integrated Circuit Emulator for
	  machines without any type of CPU.

	  http://www.libretro.com

comment "LIBRETRO_DICE needs a toolchain w/ C++"
	depends on !BR2_INSTALL_LIBSTDCPP
```

## package/libretro-dolphin/Config.in
```kconfig
config BR2_PACKAGE_LIBRETRO_DOLPHIN
	bool "libretro-dolphin"
	depends on BR2_PACKAGE_RETROARCH
	depends on BR2_PACKAGE_HAS_UDEV
	select BR2_PACKAGE_BLUEZ5_UTILS
	select BR2_PACKAGE_FMT
	select BR2_PACKAGE_LIBEVDEV
	select BR2_PACKAGE_SDL2
	select BR2_PACKAGE_VULKAN_HEADERS
	select BR2_PACKAGE_XSERVER_XORG_SERVER if BR2_PACKAGE_RECALBOX_VIDEO_XORG_SERVER
	help
	  A libretro core for GameCube / Wii emulation.

	  http://www.libretro.com
	  https://github.com/libretro/dolphin
```

## package/libretro-eightyone/Config.in
```kconfig
config BR2_PACKAGE_LIBRETRO_EIGHTYONE
	bool "libretro-eightyone"
	depends on BR2_PACKAGE_RETROARCH
	depends on BR2_INSTALL_LIBSTDCPP
	select BR2_PACKAGE_ZLIB
	help
	  A libretro core for the EeightyOne emulator.

	  https://gitlab.com/recalbox/packages/recalbox-cores/libretro-eightyone

comment "LIBRETRO_EIGHTYONE needs a toolchain w/ C++"
	depends on !BR2_INSTALL_LIBSTDCPP
```

## package/libretro-emuscv/Config.in
```kconfig
config BR2_PACKAGE_LIBRETRO_EMUSCV
	bool "libretro-emuscv"
	depends on BR2_PACKAGE_RETROARCH
	depends on BR2_INSTALL_LIBSTDCPP
	select BR2_PACKAGE_SDL2
	help
	  A libretro Super Cassette Vision emulator core for ARM.

	  http://www.libretro.com

comment "LIBRETRO_EMUSCV needs a toolchain w/ C++"
	depends on !BR2_INSTALL_LIBSTDCPP
```
