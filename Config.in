## Config.in
```kconfig
menu "Recalbox"
  menu "Audio"
    comment "Audio specific options"
    menu "Audio features"
      source "$BR2_EXTERNAL_RECALBOX_PATH/package/audio/alsa-ucm-conf/Config.in"
    endmenu
  endmenu
  menu "Firmware"
    comment "Installable linux firmwares"
    menu "Audio firmwares"
      source "$BR2_EXTERNAL_RECALBOX_PATH/package/firmware/sound-open-firmware/Config.in"
      source "$BR2_EXTERNAL_RECALBOX_PATH/package/firmware/valve-hardware-audio-processing/Config.in"
    endmenu
    menu "Steam Deck firmwares"
      source "$BR2_EXTERNAL_RECALBOX_PATH/package/firmware/kernelfirmwares-steamdeck/Config.in"
    endmenu
  endmenu
  menu "Hardware"
    comment "Board specific options"
    menu "Rockchip"
      source "$BR2_EXTERNAL_RECALBOX_PATH/package/rockchip-mpp/Config.in"
      source "$BR2_EXTERNAL_RECALBOX_PATH/package/librga/Config.in"
      source "$BR2_EXTERNAL_RECALBOX_PATH/package/rkwifibt/Config.in"
    endmenu
    menu "Hardkernel"
			menu "odroidgo2"
        source "$BR2_EXTERNAL_RECALBOX_PATH/package/libgo2/Config.in"
      endmenu
    endmenu
    comment "Cases support"
    menu "Cases"
      source "$BR2_EXTERNAL_RECALBOX_PATH/package/hardware/argon40case/Config.in"
    endmenu
  endmenu
  menu "GPU"
    comment "GPU specific options"
    menu "Rockchip"
      source "$BR2_EXTERNAL_RECALBOX_PATH/package/recalbox-rockchip-mali/Config.in"
    endmenu
    comment "libmali provided by Librelec"
    menu "Librelec"
      source "$BR2_EXTERNAL_RECALBOX_PATH/package/librelec-libmali/Config.in"
    endmenu
  endmenu
  menu "Boot"
    comment "Boot specific options"
    menu "u-boot"
      source "$BR2_EXTERNAL_RECALBOX_PATH/package/uboot-xu4/Config.in"
      source "$BR2_EXTERNAL_RECALBOX_PATH/package/uboot-odroidgo2/Config.in"
    endmenu
  endmenu
  menu "Video"
    comment "Video specific options"
    menu "Wayland"
      source "$BR2_EXTERNAL_RECALBOX_PATH/package/dwl/Config.in"
      source "$BR2_EXTERNAL_RECALBOX_PATH/package/wlr-randr/Config.in"
    endmenu
  endmenu
  menu "Emulation"
    comment "Emulation specific options"
    menu "Emulator host tooling"
      source "$BR2_EXTERNAL_RECALBOX_PATH/package/xa65/Config.in.host"
      source "$BR2_EXTERNAL_RECALBOX_PATH/package/xxd/Config.in.host"
    endmenu
  endmenu
  menu "Software"
    menu "Libraries"
      comment "Third party libraries"
      source "$BR2_EXTERNAL_RECALBOX_PATH/package/libraries/sdl2_sound/Config.in"
      source "$BR2_EXTERNAL_RECALBOX_PATH/package/libraries/sdl3/Config.in"
      source "$BR2_EXTERNAL_RECALBOX_PATH/package/libraries/sdl3_image/Config.in"
      source "$BR2_EXTERNAL_RECALBOX_PATH/package/libraries/sdl3_ttf/Config.in"
      source "$BR2_EXTERNAL_RECALBOX_PATH/package/libraries/sdl3_mixer/Config.in"
      source "$BR2_EXTERNAL_RECALBOX_PATH/package/libraries/libavif/Config.in"
      source "$BR2_EXTERNAL_RECALBOX_PATH/package/libraries/libxmp/Config.in"
      source "$BR2_EXTERNAL_RECALBOX_PATH/package/qt6tools/Config.in"
      source "$BR2_EXTERNAL_RECALBOX_PATH/package/qt6wayland/Config.in"
    endmenu
    menu "Utilities"
      comment "Utilities"
      source "$BR2_EXTERNAL_RECALBOX_PATH/package/utilities/recalbox-fbv/Config.in"
    endmenu
  endmenu
         source "$BR2_EXTERNAL_RECALBOX_PATH/package/evwait/Config.in"
         source "$BR2_EXTERNAL_RECALBOX_PATH/package/guichan/Config.in"
         source "$BR2_EXTERNAL_RECALBOX_PATH/package/libenet/Config.in"
         source "$BR2_EXTERNAL_RECALBOX_PATH/package/mali-450/Config.in"
         source "$BR2_EXTERNAL_RECALBOX_PATH/package/moonlight-embedded/Config.in"
         source "$BR2_EXTERNAL_RECALBOX_PATH/package/moonlight-qt/Config.in"
         source "$BR2_EXTERNAL_RECALBOX_PATH/package/recalbox-mupdf/Config.in"
         source "$BR2_EXTERNAL_RECALBOX_PATH/package/nvidia-driver-legacy-recalbox/Config.in"
         source "$BR2_EXTERNAL_RECALBOX_PATH/package/nvidia-driver-production-recalbox/Config.in"
         source "$BR2_EXTERNAL_RECALBOX_PATH/package/pwm-audio-pi-zero/Config.in"
         source "$BR2_EXTERNAL_RECALBOX_PATH/package/python-pygame2/Config.in"
         source "$BR2_EXTERNAL_RECALBOX_PATH/package/python-smbus2/Config.in"
         source "$BR2_EXTERNAL_RECALBOX_PATH/package/python-rpi-lgpio/Config.in"
         source "$BR2_EXTERNAL_RECALBOX_PATH/package/python-lgpio/Config.in"
         source "$BR2_EXTERNAL_RECALBOX_PATH/package/lgpio/Config.in"
         source "$BR2_EXTERNAL_RECALBOX_PATH/package/recalbox-3mounts/Config.in"
         source "$BR2_EXTERNAL_RECALBOX_PATH/package/recalbox-api/Config.in"
         source "$BR2_EXTERNAL_RECALBOX_PATH/package/recalbox-bluetooth/Config.in"
         source "$BR2_EXTERNAL_RECALBOX_PATH/package/recalbox-bootia32/Config.in"
         source "$BR2_EXTERNAL_RECALBOX_PATH/package/recalbox-configgen/Config.in"
         source "$BR2_EXTERNAL_RECALBOX_PATH/package/recalbox-initramfs/Config.in"
         source "$BR2_EXTERNAL_RECALBOX_PATH/package/recalbox-luajit/Config.in"
         source "$BR2_EXTERNAL_RECALBOX_PATH/package/recalbox-manager3/Config.in"
         source "$BR2_EXTERNAL_RECALBOX_PATH/package/recalbox-mplayer/Config.in"
         source "$BR2_EXTERNAL_RECALBOX_PATH/package/recalbox-piboy/Config.in"
         source "$BR2_EXTERNAL_RECALBOX_PATH/package/recalbox-romfs2/Config.in"
         source "$BR2_EXTERNAL_RECALBOX_PATH/package/recalbox-system/Config.in"
         source "$BR2_EXTERNAL_RECALBOX_PATH/package/recalbox-tft-assets/Config.in"
         source "$BR2_EXTERNAL_RECALBOX_PATH/package/recalbox-themes/Config.in"
         source "$BR2_EXTERNAL_RECALBOX_PATH/package/recalbox-videomode/Config.in"
         source "$BR2_EXTERNAL_RECALBOX_PATH/package/recalbox-wifi/Config.in"
         source "$BR2_EXTERNAL_RECALBOX_PATH/package/recalbox-x86_64_efi/Config.in"
         source "$BR2_EXTERNAL_RECALBOX_PATH/package/recalbox-rgb-dual/Config.in"
         source "$BR2_EXTERNAL_RECALBOX_PATH/package/recalbox-rgb-jamma/Config.in"
         source "$BR2_EXTERNAL_RECALBOX_PATH/package/recalbox-rgb-jamma-2/Config.in"
         source "$BR2_EXTERNAL_RECALBOX_PATH/package/recalbox-card-reader/Config.in"
         source "$BR2_EXTERNAL_RECALBOX_PATH/package/recalbox-jvs/Config.in"
         source "$BR2_EXTERNAL_RECALBOX_PATH/package/recalbox-input-lag-tools/Config.in"
         source "$BR2_EXTERNAL_RECALBOX_PATH/package/recalbox-i2s-audio/Config.in"
         source "$BR2_EXTERNAL_RECALBOX_PATH/package/recalbox-postconf/Config.in"
         source "$BR2_EXTERNAL_RECALBOX_PATH/package/recalbox-rgb-dual-guncon2/Config.in"
         source "$BR2_EXTERNAL_RECALBOX_PATH/package/recalbox-allinone/Config.in"
         source "$BR2_EXTERNAL_RECALBOX_PATH/package/recalbox-gamepad-proxy/Config.in"
         source "$BR2_EXTERNAL_RECALBOX_PATH/package/sfml/Config.in"
         source "$BR2_EXTERNAL_RECALBOX_PATH/package/tft-waveshare/Config.in"
         source "$BR2_EXTERNAL_RECALBOX_PATH/package/recalbox-hardware/Config.in"
         source "$BR2_EXTERNAL_RECALBOX_PATH/package/recalbox-settings/Config.in"
         source "$BR2_EXTERNAL_RECALBOX_PATH/package/wxwidgets/Config.in"
menu "Emulationstation"
         source "$BR2_EXTERNAL_RECALBOX_PATH/package/recalbox-emulationstation2/Config.in"
endmenu
menu "Controllers"
         source "$BR2_EXTERNAL_RECALBOX_PATH/package/db9_gpio_rpi/Config.in"
         source "$BR2_EXTERNAL_RECALBOX_PATH/package/gamecon_gpio_rpi/Config.in"
         source "$BR2_EXTERNAL_RECALBOX_PATH/package/mk_arcade_joystick_rpi/Config.in"
         source "$BR2_EXTERNAL_RECALBOX_PATH/package/qtsixa-shanwan/Config.in"
         source "$BR2_EXTERNAL_RECALBOX_PATH/package/qtsixa/Config.in"
         source "$BR2_EXTERNAL_RECALBOX_PATH/package/recalbox-retrogame/Config.in"
         source "$BR2_EXTERNAL_RECALBOX_PATH/package/steamcontroller/Config.in"
         source "$BR2_EXTERNAL_RECALBOX_PATH/package/virtualgamepads/Config.in"
         source "$BR2_EXTERNAL_RECALBOX_PATH/package/wii-u-gc-adapter/Config.in"
         source "$BR2_EXTERNAL_RECALBOX_PATH/package/xarcade2jstick/Config.in"
         comment "Microsoft Xbox controller support"
         source "$BR2_EXTERNAL_RECALBOX_PATH/package/xboxdrv/Config.in"
         source "$BR2_EXTERNAL_RECALBOX_PATH/package/xpadneo/Config.in"
         source "$BR2_EXTERNAL_RECALBOX_PATH/package/xone/Config.in"
         source "$BR2_EXTERNAL_RECALBOX_PATH/package/xpad-noone/Config.in"
         comment "Nintendo switch Joycons support"
         source "$BR2_EXTERNAL_RECALBOX_PATH/package/joycond/Config.in"
         comment "Piboy DMG XPI Gamecon support"
         source "$BR2_EXTERNAL_RECALBOX_PATH/package/xpi_gamecon_rpi/Config.in"
         source "$BR2_EXTERNAL_RECALBOX_PATH/package/recalbox-volumed/Config.in"
         source "$BR2_EXTERNAL_RECALBOX_PATH/package/taito-pt/Config.in"
endmenu
menu "Emulators"
         source "$BR2_EXTERNAL_RECALBOX_PATH/package/advancemame/Config.in"
         source "$BR2_EXTERNAL_RECALBOX_PATH/package/beebem/Config.in"
         source "$BR2_EXTERNAL_RECALBOX_PATH/package/corsixth/Config.in"
         source "$BR2_EXTERNAL_RECALBOX_PATH/package/frotz-recalbox/Config.in"
         source "$BR2_EXTERNAL_RECALBOX_PATH/package/hatari/Config.in"
         source "$BR2_EXTERNAL_RECALBOX_PATH/package/duckstation/Config.in"
         source "$BR2_EXTERNAL_RECALBOX_PATH/package/julius/Config.in"
         source "$BR2_EXTERNAL_RECALBOX_PATH/package/mupen64plus-audio-sdl/Config.in"
         source "$BR2_EXTERNAL_RECALBOX_PATH/package/mupen64plus-core/Config.in"
         source "$BR2_EXTERNAL_RECALBOX_PATH/package/mupen64plus-gliden64/Config.in"
         source "$BR2_EXTERNAL_RECALBOX_PATH/package/mupen64plus-gliden64-20/Config.in"
         source "$BR2_EXTERNAL_RECALBOX_PATH/package/mupen64plus-input-sdl/Config.in"
         source "$BR2_EXTERNAL_RECALBOX_PATH/package/mupen64plus-omx/Config.in"
         source "$BR2_EXTERNAL_RECALBOX_PATH/package/mupen64plus-video-gles2n64/Config.in"
         source "$BR2_EXTERNAL_RECALBOX_PATH/package/mupen64plus-video-gles2rice/Config.in"
         source "$BR2_EXTERNAL_RECALBOX_PATH/package/mupen64plus-video-rice/Config.in"
         source "$BR2_EXTERNAL_RECALBOX_PATH/package/mupen64plus-rsphle/Config.in"
         source "$BR2_EXTERNAL_RECALBOX_PATH/package/mupen64plus-uiconsole/Config.in"
         source "$BR2_EXTERNAL_RECALBOX_PATH/package/mupen64plus-video-glide64mk2/Config.in"
         source "$BR2_EXTERNAL_RECALBOX_PATH/package/openlara/Config.in"
         source "$BR2_EXTERNAL_RECALBOX_PATH/package/oricutron/Config.in"
         source "$BR2_EXTERNAL_RECALBOX_PATH/package/ppsspp/Config.in"
         source "$BR2_EXTERNAL_RECALBOX_PATH/package/simcoupe/Config.in"
         source "$BR2_EXTERNAL_RECALBOX_PATH/package/amiberry/Config.in"
         source "$BR2_EXTERNAL_RECALBOX_PATH/package/amiberry33/Config.in"
         source "$BR2_EXTERNAL_RECALBOX_PATH/package/dolphin-emu/Config.in"
         source "$BR2_EXTERNAL_RECALBOX_PATH/package/dosbox/Config.in"
         source "$BR2_EXTERNAL_RECALBOX_PATH/package/gsplus/Config.in"
         source "$BR2_EXTERNAL_RECALBOX_PATH/package/hypseus/Config.in"
         source "$BR2_EXTERNAL_RECALBOX_PATH/package/openbor/Config.in"
         source "$BR2_EXTERNAL_RECALBOX_PATH/package/pcsx_rearmed/Config.in"
         source "$BR2_EXTERNAL_RECALBOX_PATH/package/pcsx2/Config.in"
         source "$BR2_EXTERNAL_RECALBOX_PATH/package/pico8-lexaloffle/Config.in"
         source "$BR2_EXTERNAL_RECALBOX_PATH/package/pifba/Config.in"
         source "$BR2_EXTERNAL_RECALBOX_PATH/package/pisnes/Config.in"
         source "$BR2_EXTERNAL_RECALBOX_PATH/package/rb5000/Config.in"
         source "$BR2_EXTERNAL_RECALBOX_PATH/package/reicast-old/Config.in"
         source "$BR2_EXTERNAL_RECALBOX_PATH/package/reicast/Config.in"
         source "$BR2_EXTERNAL_RECALBOX_PATH/package/retroarch-assets/Config.in"
         source "$BR2_EXTERNAL_RECALBOX_PATH/package/retroarch/Config.in"
         source "$BR2_EXTERNAL_RECALBOX_PATH/package/scummvm/Config.in"
         source "$BR2_EXTERNAL_RECALBOX_PATH/package/sdlpop/Config.in"
         source "$BR2_EXTERNAL_RECALBOX_PATH/package/vice/Config.in"
         source "$BR2_EXTERNAL_RECALBOX_PATH/package/solarus-recalbox/Config.in"
         source "$BR2_EXTERNAL_RECALBOX_PATH/package/supermodel/Config.in"
         source "$BR2_EXTERNAL_RECALBOX_PATH/package/ti99sim/Config.in"
         source "$BR2_EXTERNAL_RECALBOX_PATH/package/xemu/Config.in"
         source "$BR2_EXTERNAL_RECALBOX_PATH/package/xroar/Config.in"
	 source "$BR2_EXTERNAL_RECALBOX_PATH/package/vvvvvv/Config.in"
         source "$BR2_EXTERNAL_RECALBOX_PATH/package/vpinball/Config.in"

if BR2_PACKAGE_RETROARCH
menu "Libretro Cores"
        source "$BR2_EXTERNAL_RECALBOX_PATH/package/libretro-81/Config.in"
        source "$BR2_EXTERNAL_RECALBOX_PATH/package/libretro-2048/Config.in"
        source "$BR2_EXTERNAL_RECALBOX_PATH/package/libretro-a5200/Config.in"
        source "$BR2_EXTERNAL_RECALBOX_PATH/package/libretro-applewin/Config.in"
        source "$BR2_EXTERNAL_RECALBOX_PATH/package/libretro-atari800/Config.in"
        source "$BR2_EXTERNAL_RECALBOX_PATH/package/libretro-arduous/Config.in"
        source "$BR2_EXTERNAL_RECALBOX_PATH/package/libretro-b2/Config.in"
        source "$BR2_EXTERNAL_RECALBOX_PATH/package/libretro-bk-emulator/Config.in"
        source "$BR2_EXTERNAL_RECALBOX_PATH/package/libretro-freeintv/Config.in"
        source "$BR2_EXTERNAL_RECALBOX_PATH/package/libretro-beetle-lynx/Config.in"
        source "$BR2_EXTERNAL_RECALBOX_PATH/package/libretro-beetle-ngp/Config.in"
        source "$BR2_EXTERNAL_RECALBOX_PATH/package/libretro-beetle-pce-fast/Config.in"
        source "$BR2_EXTERNAL_RECALBOX_PATH/package/libretro-beetle-pcfx/Config.in"
        source "$BR2_EXTERNAL_RECALBOX_PATH/package/libretro-beetle-psx-hw/Config.in"
        source "$BR2_EXTERNAL_RECALBOX_PATH/package/libretro-beetle-psx/Config.in"
        source "$BR2_EXTERNAL_RECALBOX_PATH/package/libretro-beetle-saturn/Config.in"
        source "$BR2_EXTERNAL_RECALBOX_PATH/package/libretro-beetle-supergrafx/Config.in"
        source "$BR2_EXTERNAL_RECALBOX_PATH/package/libretro-beetle-vb/Config.in"
        source "$BR2_EXTERNAL_RECALBOX_PATH/package/libretro-beetle-wswan/Config.in"
        source "$BR2_EXTERNAL_RECALBOX_PATH/package/libretro-bluemsx/Config.in"
        source "$BR2_EXTERNAL_RECALBOX_PATH/package/libretro-boom3/Config.in"
        source "$BR2_EXTERNAL_RECALBOX_PATH/package/libretro-bsnes/Config.in"
        source "$BR2_EXTERNAL_RECALBOX_PATH/package/libretro-bsnes-hd/Config.in"
        source "$BR2_EXTERNAL_RECALBOX_PATH/package/libretro-cannonball/Config.in"
        source "$BR2_EXTERNAL_RECALBOX_PATH/package/libretro-cap32/Config.in"
        source "$BR2_EXTERNAL_RECALBOX_PATH/package/libretro-cdi2015/Config.in"
        source "$BR2_EXTERNAL_RECALBOX_PATH/package/libretro-craft/Config.in"
        source "$BR2_EXTERNAL_RECALBOX_PATH/package/libretro-crawl/Config.in"
        source "$BR2_EXTERNAL_RECALBOX_PATH/package/libretro-crocods/Config.in"
        source "$BR2_EXTERNAL_RECALBOX_PATH/package/libretro-desmume/Config.in"
        source "$BR2_EXTERNAL_RECALBOX_PATH/package/libretro-dice/Config.in"
        source "$BR2_EXTERNAL_RECALBOX_PATH/package/libretro-dinothawr/Config.in"
        source "$BR2_EXTERNAL_RECALBOX_PATH/package/libretro-dirksimple/Config.in"
        source "$BR2_EXTERNAL_RECALBOX_PATH/package/libretro-dolphin/Config.in"
        source "$BR2_EXTERNAL_RECALBOX_PATH/package/libretro-dosbox-pure/Config.in"
        source "$BR2_EXTERNAL_RECALBOX_PATH/package/libretro-easyrpg/Config.in"
        source "$BR2_EXTERNAL_RECALBOX_PATH/package/libretro-ecwolf/Config.in"
        source "$BR2_EXTERNAL_RECALBOX_PATH/package/libretro-eightyone/Config.in"
        source "$BR2_EXTERNAL_RECALBOX_PATH/package/libretro-emuscv/Config.in"
        source "$BR2_EXTERNAL_RECALBOX_PATH/package/libretro-fake08/Config.in"
        source "$BR2_EXTERNAL_RECALBOX_PATH/package/libretro-fbneo/Config.in"
        source "$BR2_EXTERNAL_RECALBOX_PATH/package/libretro-fceumm/Config.in"
        source "$BR2_EXTERNAL_RECALBOX_PATH/package/libretro-flycast-next/Config.in"
        source "$BR2_EXTERNAL_RECALBOX_PATH/package/libretro-flycast/Config.in"
        source "$BR2_EXTERNAL_RECALBOX_PATH/package/libretro-fmsx/Config.in"
        source "$BR2_EXTERNAL_RECALBOX_PATH/package/libretro-freechaf/Config.in"
        source "$BR2_EXTERNAL_RECALBOX_PATH/package/libretro-fuse/Config.in"
        source "$BR2_EXTERNAL_RECALBOX_PATH/package/libretro-gambatte/Config.in"
        source "$BR2_EXTERNAL_RECALBOX_PATH/package/libretro-gearcoleco/Config.in"
        source "$BR2_EXTERNAL_RECALBOX_PATH/package/libretro-geargrafx/Config.in"
        source "$BR2_EXTERNAL_RECALBOX_PATH/package/libretro-gearsystem/Config.in"
        source "$BR2_EXTERNAL_RECALBOX_PATH/package/libretro-genesisplusgx/Config.in"
        source "$BR2_EXTERNAL_RECALBOX_PATH/package/libretro-genesisplusgx-ex/Config.in"
        source "$BR2_EXTERNAL_RECALBOX_PATH/package/libretro-genesisplusgxwide/Config.in"
        source "$BR2_EXTERNAL_RECALBOX_PATH/package/libretro-geolith/Config.in"
        source "$BR2_EXTERNAL_RECALBOX_PATH/package/libretro-gong/Config.in"
        source "$BR2_EXTERNAL_RECALBOX_PATH/package/libretro-gpsp/Config.in"
        source "$BR2_EXTERNAL_RECALBOX_PATH/package/libretro-gw/Config.in"
        source "$BR2_EXTERNAL_RECALBOX_PATH/package/libretro-handy/Config.in"
        source "$BR2_EXTERNAL_RECALBOX_PATH/package/libretro-hatari/Config.in"
        source "$BR2_EXTERNAL_RECALBOX_PATH/package/libretro-hatarib/Config.in"
        source "$BR2_EXTERNAL_RECALBOX_PATH/package/libretro-hypseus-singe/Config.in"
        source "$BR2_EXTERNAL_RECALBOX_PATH/package/libretro-imageviewer/Config.in"
        source "$BR2_EXTERNAL_RECALBOX_PATH/package/libretro-kronos/Config.in"
        source "$BR2_EXTERNAL_RECALBOX_PATH/package/libretro-lowres-nx/Config.in"
        source "$BR2_EXTERNAL_RECALBOX_PATH/package/libretro-lutro/Config.in"
        source "$BR2_EXTERNAL_RECALBOX_PATH/package/libretro-mame0278/Config.in"
        source "$BR2_EXTERNAL_RECALBOX_PATH/package/libretro-m2000/Config.in"
        source "$BR2_EXTERNAL_RECALBOX_PATH/package/libretro-mame2000/Config.in"
        source "$BR2_EXTERNAL_RECALBOX_PATH/package/libretro-mame2003-plus/Config.in"
        source "$BR2_EXTERNAL_RECALBOX_PATH/package/libretro-mame2003/Config.in"
        source "$BR2_EXTERNAL_RECALBOX_PATH/package/libretro-mame2010/Config.in"
        source "$BR2_EXTERNAL_RECALBOX_PATH/package/libretro-mame2015/Config.in"
        source "$BR2_EXTERNAL_RECALBOX_PATH/package/libretro-mame2016/Config.in"
        source "$BR2_EXTERNAL_RECALBOX_PATH/package/libretro-mame0258/Config.in"
        source "$BR2_EXTERNAL_RECALBOX_PATH/package/libretro-mednafen-stv/Config.in"
        source "$BR2_EXTERNAL_RECALBOX_PATH/package/libretro-melonds/Config.in"
        source "$BR2_EXTERNAL_RECALBOX_PATH/package/libretro-mesen/Config.in"
        source "$BR2_EXTERNAL_RECALBOX_PATH/package/libretro-mesen-s/Config.in"
        source "$BR2_EXTERNAL_RECALBOX_PATH/package/libretro-meteor/Config.in"
        source "$BR2_EXTERNAL_RECALBOX_PATH/package/libretro-mgba/Config.in"
        source "$BR2_EXTERNAL_RECALBOX_PATH/package/libretro-minivmac/Config.in"
        source "$BR2_EXTERNAL_RECALBOX_PATH/package/libretro-mojozork/Config.in"
        source "$BR2_EXTERNAL_RECALBOX_PATH/package/libretro-mrboom/Config.in"
        source "$BR2_EXTERNAL_RECALBOX_PATH/package/libretro-mu/Config.in"
        source "$BR2_EXTERNAL_RECALBOX_PATH/package/libretro-mupen64plus/Config.in"
        source "$BR2_EXTERNAL_RECALBOX_PATH/package/libretro-mupen64plus-nx/Config.in"
        source "$BR2_EXTERNAL_RECALBOX_PATH/package/libretro-neocd/Config.in"
        source "$BR2_EXTERNAL_RECALBOX_PATH/package/libretro-nestopia/Config.in"
        source "$BR2_EXTERNAL_RECALBOX_PATH/package/libretro-np2kai/Config.in"
        source "$BR2_EXTERNAL_RECALBOX_PATH/package/libretro-nxengine/Config.in"
        source "$BR2_EXTERNAL_RECALBOX_PATH/package/libretro-o2em/Config.in"
        source "$BR2_EXTERNAL_RECALBOX_PATH/package/libretro-opera/Config.in"
        source "$BR2_EXTERNAL_RECALBOX_PATH/package/libretro-parallel-n64/Config.in"
        source "$BR2_EXTERNAL_RECALBOX_PATH/package/libretro-pcsx_rearmed/Config.in"
        source "$BR2_EXTERNAL_RECALBOX_PATH/package/libretro-pcsx2/Config.in"
        source "$BR2_EXTERNAL_RECALBOX_PATH/package/libretro-pd777/Config.in"
        source "$BR2_EXTERNAL_RECALBOX_PATH/package/libretro-picodrive/Config.in"
        source "$BR2_EXTERNAL_RECALBOX_PATH/package/libretro-pokemini/Config.in"
        source "$BR2_EXTERNAL_RECALBOX_PATH/package/libretro-potator/Config.in"
        source "$BR2_EXTERNAL_RECALBOX_PATH/package/libretro-prboom/Config.in"
        source "$BR2_EXTERNAL_RECALBOX_PATH/package/libretro-prosystem/Config.in"
        source "$BR2_EXTERNAL_RECALBOX_PATH/package/libretro-ps2/Config.in"
        source "$BR2_EXTERNAL_RECALBOX_PATH/package/libretro-px68k/Config.in"
        source "$BR2_EXTERNAL_RECALBOX_PATH/package/libretro-quasi88/Config.in"
        source "$BR2_EXTERNAL_RECALBOX_PATH/package/libretro-quicknes/Config.in"
        source "$BR2_EXTERNAL_RECALBOX_PATH/package/libretro-race/Config.in"
        source "$BR2_EXTERNAL_RECALBOX_PATH/package/libretro-exel-hence/Config.in"
        source "$BR2_EXTERNAL_RECALBOX_PATH/package/libretro-rb5000/Config.in"
        source "$BR2_EXTERNAL_RECALBOX_PATH/package/libretro-reminiscence/Config.in"
        source "$BR2_EXTERNAL_RECALBOX_PATH/package/libretro-retro8/Config.in"
        source "$BR2_EXTERNAL_RECALBOX_PATH/package/libretro-retrodream/Config.in"
        source "$BR2_EXTERNAL_RECALBOX_PATH/package/libretro-sameboy/Config.in"
        source "$BR2_EXTERNAL_RECALBOX_PATH/package/libretro-sameduck/Config.in"
        source "$BR2_EXTERNAL_RECALBOX_PATH/package/libretro-same_cdi/Config.in"
        source "$BR2_EXTERNAL_RECALBOX_PATH/package/libretro-scummvm/Config.in"
        source "$BR2_EXTERNAL_RECALBOX_PATH/package/libretro-snes9x/Config.in"
        source "$BR2_EXTERNAL_RECALBOX_PATH/package/libretro-snes9x2002/Config.in"
        source "$BR2_EXTERNAL_RECALBOX_PATH/package/libretro-snes9x2005/Config.in"
        source "$BR2_EXTERNAL_RECALBOX_PATH/package/libretro-snes9x2010/Config.in"
        source "$BR2_EXTERNAL_RECALBOX_PATH/package/libretro-stella/Config.in"
        source "$BR2_EXTERNAL_RECALBOX_PATH/package/libretro-stella2014/Config.in"
        source "$BR2_EXTERNAL_RECALBOX_PATH/package/libretro-sugarbox2/Config.in"
        source "$BR2_EXTERNAL_RECALBOX_PATH/package/libretro-supafaust/Config.in"
        source "$BR2_EXTERNAL_RECALBOX_PATH/package/libretro-swanstation/Config.in"
        source "$BR2_EXTERNAL_RECALBOX_PATH/package/libretro-tamalibretro/Config.in"
        source "$BR2_EXTERNAL_RECALBOX_PATH/package/libretro-tgbdual/Config.in"
        source "$BR2_EXTERNAL_RECALBOX_PATH/package/libretro-theodore/Config.in"
        source "$BR2_EXTERNAL_RECALBOX_PATH/package/libretro-thepowdertoy/Config.in"
        source "$BR2_EXTERNAL_RECALBOX_PATH/package/libretro-tic80/Config.in"
        source "$BR2_EXTERNAL_RECALBOX_PATH/package/libretro-tyrquake/Config.in"
        source "$BR2_EXTERNAL_RECALBOX_PATH/package/libretro-uae/Config.in"
        source "$BR2_EXTERNAL_RECALBOX_PATH/package/libretro-uae-2021/Config.in"
        source "$BR2_EXTERNAL_RECALBOX_PATH/package/libretro-uae4arm/Config.in"
        source "$BR2_EXTERNAL_RECALBOX_PATH/package/libretro-uae4all/Config.in"
        source "$BR2_EXTERNAL_RECALBOX_PATH/package/libretro-uzem/Config.in"
        source "$BR2_EXTERNAL_RECALBOX_PATH/package/libretro-vecx/Config.in"
        source "$BR2_EXTERNAL_RECALBOX_PATH/package/libretro-vice/Config.in"
        source "$BR2_EXTERNAL_RECALBOX_PATH/package/libretro-vircon32/Config.in"
        source "$BR2_EXTERNAL_RECALBOX_PATH/package/libretro-virtualjaguar/Config.in"
        source "$BR2_EXTERNAL_RECALBOX_PATH/package/libretro-vitaquake2/Config.in"
        source "$BR2_EXTERNAL_RECALBOX_PATH/package/libretro-vitaquake3/Config.in"
        source "$BR2_EXTERNAL_RECALBOX_PATH/package/libretro-vitavoyager/Config.in"
        source "$BR2_EXTERNAL_RECALBOX_PATH/package/libretro-xmil/Config.in"
        source "$BR2_EXTERNAL_RECALBOX_PATH/package/libretro-xrick/Config.in"
        source "$BR2_EXTERNAL_RECALBOX_PATH/package/libretro-yabasanshiro/Config.in"
        source "$BR2_EXTERNAL_RECALBOX_PATH/package/libretro-yabause/Config.in"
        source "$BR2_EXTERNAL_RECALBOX_PATH/package/libretro-ppsspp/Config.in"
        source "$BR2_EXTERNAL_RECALBOX_PATH/package/libretro-wasm4/Config.in"
        source "$BR2_EXTERNAL_RECALBOX_PATH/package/libretro-holani/Config.in"
        source "$BR2_EXTERNAL_RECALBOX_PATH/package/libretro-amiberry/Config.in"
        source "$BR2_EXTERNAL_RECALBOX_PATH/package/libretro-ymir/Config.in"
endmenu
endif
endmenu
menu "Ports"
         source "$BR2_EXTERNAL_RECALBOX_PATH/package/vvvvvv/Config.in"
endmenu
menu "Kodi addons"
         source "$BR2_EXTERNAL_RECALBOX_PATH/package/kodi-plugin-video-netflix/Config.in"
         source "$BR2_EXTERNAL_RECALBOX_PATH/package/kodi-plugin-video-twitch/Config.in"
         source "$BR2_EXTERNAL_RECALBOX_PATH/package/kodi-plugin-video-youtube/Config.in"
         source "$BR2_EXTERNAL_RECALBOX_PATH/package/kodi-plugin-video-freebox/Config.in"
         source "$BR2_EXTERNAL_RECALBOX_PATH/package/kodi-plugin-video-crunchyroll/Config.in"
         source "$BR2_EXTERNAL_RECALBOX_PATH/package/kodi-plugin-video-orange/Config.in"
         source "$BR2_EXTERNAL_RECALBOX_PATH/package/kodi-plugin-video-plex/Config.in"
         source "$BR2_EXTERNAL_RECALBOX_PATH/package/kodi-script-module-addon-signals/Config.in"
         source "$BR2_EXTERNAL_RECALBOX_PATH/package/kodi-script-module-inputstreamhelper/Config.in"
         source "$BR2_EXTERNAL_RECALBOX_PATH/package/kodi-script-module-future/Config.in"
         source "$BR2_EXTERNAL_RECALBOX_PATH/package/kodi-script-module-requests/Config.in"
         source "$BR2_EXTERNAL_RECALBOX_PATH/package/kodi-script-module-certifi/Config.in"
         source "$BR2_EXTERNAL_RECALBOX_PATH/package/kodi-script-module-chardet/Config.in"
         source "$BR2_EXTERNAL_RECALBOX_PATH/package/kodi-script-module-idna/Config.in"
         source "$BR2_EXTERNAL_RECALBOX_PATH/package/kodi-script-module-urllib3/Config.in"
         source "$BR2_EXTERNAL_RECALBOX_PATH/package/kodi-script-module-myconnpy/Config.in"
         source "$BR2_EXTERNAL_RECALBOX_PATH/package/kodi-script-module-python-twitch/Config.in"
         source "$BR2_EXTERNAL_RECALBOX_PATH/package/kodi-script-module-six/Config.in"
         source "$BR2_EXTERNAL_RECALBOX_PATH/package/kodi-script-module-routing/Config.in"
         source "$BR2_EXTERNAL_RECALBOX_PATH/package/kodi-script-module-kodi-six/Config.in"
menu "Languages"
         source "$BR2_EXTERNAL_RECALBOX_PATH/package/kodi-resource-language-de_de/Config.in"
         source "$BR2_EXTERNAL_RECALBOX_PATH/package/kodi-resource-language-es_es/Config.in"
         source "$BR2_EXTERNAL_RECALBOX_PATH/package/kodi-resource-language-eu_es/Config.in"
         source "$BR2_EXTERNAL_RECALBOX_PATH/package/kodi-resource-language-fr_fr/Config.in"
         source "$BR2_EXTERNAL_RECALBOX_PATH/package/kodi-resource-language-it_it/Config.in"
         source "$BR2_EXTERNAL_RECALBOX_PATH/package/kodi-resource-language-pt_br/Config.in"
         source "$BR2_EXTERNAL_RECALBOX_PATH/package/kodi-resource-language-sv_se/Config.in"
         source "$BR2_EXTERNAL_RECALBOX_PATH/package/kodi-resource-language-tr_tr/Config.in"
         source "$BR2_EXTERNAL_RECALBOX_PATH/package/kodi-resource-language-zh_cn/Config.in"
endmenu
menu "Skins"
         source "$BR2_EXTERNAL_RECALBOX_PATH/package/kodi-skin-confluence-480/Config.in"
endmenu
endmenu
menu "Utils"
         source "$BR2_EXTERNAL_RECALBOX_PATH/package/hhpc/Config.in"
         source "$BR2_EXTERNAL_RECALBOX_PATH/package/hyperion/Config.in"
         source "$BR2_EXTERNAL_RECALBOX_PATH/package/jstest2/Config.in"
         source "$BR2_EXTERNAL_RECALBOX_PATH/package/kernelfirmwares/Config.in"
         source "$BR2_EXTERNAL_RECALBOX_PATH/package/brcm-bt-firmware/Config.in"
         source "$BR2_EXTERNAL_RECALBOX_PATH/package/rtl8812au/Config.in"
         source "$BR2_EXTERNAL_RECALBOX_PATH/package/rtl88x2bu/Config.in"
         source "$BR2_EXTERNAL_RECALBOX_PATH/package/rtw89/Config.in"
         source "$BR2_EXTERNAL_RECALBOX_PATH/package/libcapsimage/Config.in"
         source "$BR2_EXTERNAL_RECALBOX_PATH/package/libretro-cheats/Config.in"
         source "$BR2_EXTERNAL_RECALBOX_PATH/package/nanoarch/Config.in"
         source "$BR2_EXTERNAL_RECALBOX_PATH/package/raspi2png/Config.in"
         source "$BR2_EXTERNAL_RECALBOX_PATH/package/switchres/Config.in"
         source "$BR2_EXTERNAL_RECALBOX_PATH/package/recalbox-crt/Config.in"
         source "$BR2_EXTERNAL_RECALBOX_PATH/package/liblcf/Config.in"
         source "$BR2_EXTERNAL_RECALBOX_PATH/package/libxmp-lite/Config.in"
         source "$BR2_EXTERNAL_RECALBOX_PATH/package/wildmidi/Config.in"
         source "$BR2_EXTERNAL_RECALBOX_PATH/package/lba-finder/Config.in"
         source "$BR2_EXTERNAL_RECALBOX_PATH/package/pm-utils/Config.in"
         source "$BR2_EXTERNAL_RECALBOX_PATH/package/wsd/Config.in"
         source "$BR2_EXTERNAL_RECALBOX_PATH/package/pamix/Config.in"
         source "$BR2_EXTERNAL_RECALBOX_PATH/package/kmsgrab/Config.in"
         source "$BR2_EXTERNAL_RECALBOX_PATH/package/eepromutils/Config.in"
         source "$BR2_EXTERNAL_RECALBOX_PATH/package/arcade-dats/Config.in"
         source "$BR2_EXTERNAL_RECALBOX_PATH/package/rpi-eeprom/Config.in"
         source "$BR2_EXTERNAL_RECALBOX_PATH/package/rpi-utils/Config.in"
         source "$BR2_EXTERNAL_RECALBOX_PATH/package/nodejs-quasar/Config.in.host"
         source "$BR2_EXTERNAL_RECALBOX_PATH/package/recalbox-drm-info/Config.in"
         source "$BR2_EXTERNAL_RECALBOX_PATH/package/grim/Config.in"
endmenu
menu "Small TFT Screen"
         source "$BR2_EXTERNAL_RECALBOX_PATH/package/rpi-fbcp/Config.in"
endmenu
menu "Pi Hats"
         source "$BR2_EXTERNAL_RECALBOX_PATH/package/recalbox-wpaf/Config.in"
endmenu
if BR2_PACKAGE_VPINBALL
menu "Libraries"
         source "$BR2_EXTERNAL_RECALBOX_PATH/package/libaltsound/Config.in"
         source "$BR2_EXTERNAL_RECALBOX_PATH/package/libdmdutil/Config.in"
         source "$BR2_EXTERNAL_RECALBOX_PATH/package/libdmdutil/Config.in"
         source "$BR2_EXTERNAL_RECALBOX_PATH/package/libpupdmd/Config.in"
         source "$BR2_EXTERNAL_RECALBOX_PATH/package/libserum/Config.in"
         source "$BR2_EXTERNAL_RECALBOX_PATH/package/libzedmd/Config.in"
         source "$BR2_EXTERNAL_RECALBOX_PATH/package/libvni/Config.in"
         source "$BR2_EXTERNAL_RECALBOX_PATH/package/libframeutil/Config.in"
         source "$BR2_EXTERNAL_RECALBOX_PATH/package/sockpp/Config.in"
         source "$BR2_EXTERNAL_RECALBOX_PATH/package/libdof/Config.in"
         source "$BR2_EXTERNAL_RECALBOX_PATH/package/libpinmame/Config.in"
         source "$BR2_EXTERNAL_RECALBOX_PATH/package/cargs/Config.in"
         source "$BR2_EXTERNAL_RECALBOX_PATH/package/libwinevbs/Config.in"
endmenu
endif
endmenu
```
